;+-------------------------------------------------------------
;| Generate Assembler File for Atmel AVR Studio 4..7
;|
;| Source
;|     Path : C:\_AVR\_CURINGA2018\RESOURCES\
;|     File : Logo Curinga Flat - 128x32.bmp
;|
;| Destiny
;|     Path : C:\_AVR\_CURINGA2018\RESOURCES\
;|     File : BMP_Logo Curinga Flat - 128x32.INC
;|
;| Destiny Image Properties
;|     Size   :   512 Bytes
;|     Width  :   128 Pixels
;|     Height :    32 Pixels
;|     WidthB :    16 Bytes
;|     Colors :     2 Levels(1) Bit
;+-------------------------------------------------------------

;( IMAGE CONTENTS )

;                                                                                                         1                           
;               1         2         3         4         5         6         7         8         9         0         1         2       
;     01234567890123456789012345678901234567890123456789012345678901234567890123456789012345678901234567890123456789012345678901234567
;     |         |         |         |         |         |         |         |         |         |         |         |         |       
;0000-################################################################################################################################-   0
;0001-################################################################################################################################-   1
;0002-################################################################################################################################-   2
;0003-################################################################################################################################-   3
;0004-################################################################################################################################-   4
;0005-################################################################################################################################-   5
;0006-################################################################################################################################-   6
;0007-################################################################################################################################-   7
;0008-######              ##       ########  ##                 ####      ##     ###########   ####              ############   ######-   8
;0009-#####              ###      #########  ##                 ###       ##       #########  ###               ############  # ######-   9
;0010-###       ###########       ########   #       #####      ###      ##          ######   ##       ###################   ##  #####-  10
;0011-###       ###########      #########  ##      #####       ###      ##            ####   #       ###################    #    ####-  11
;0012-##       ###########       ########   #       #          ###      ##               #   ##       #####     #######      #    ####-  12
;0013-##       ###########      #########  ##      ##       ######      ##                   #       #####     #######      ##     ###-  13
;0014-#       ###########       ########   ##      ###      #####      ##   ###             ##       #####     #####        ##     ###-  14
;0015-#       ###########       #######   ##      ####       ####      ##   #####           ##      #####      ####        ###      ##-  15
;0016-#       ###########       ######   ###      #####      ###      ##   ########        ###       ####     ###          ###      ##-  16
;0017-##              ###               ###      ######       ##      ##   ###########     ####               ##          ####       #-  17
;0018-###             #####          ######      #######      ##     ###  ##############  ######             ##           ####       #-  18
;0019-################################################################################################################################-  19
;0020-###     ##############  ####  ##   #################################################################       ##       ####      ##-  20
;0021-#        #  #########    ##        ################################################################ ######### ###### ## ########-  21
;0022-#  #######  #########    #####  ################################################################## ###    ###        ##       ##-  22
;0023-#  #   ###  ########  ##  ####  ################################################################## ####### ## ################ #-  23
;0024-#  #######  ######## ###  ####  ###################################################################        ############        #-  24
;0025-#  #######   ######  #     ###  ################################################################################################-  25
;0026-#  ########      ## ######  ##  ################################################################################################-  26
;0027-################################################################################################################################-  27
;0028-################################################################################################################################-  28
;0029-################################################################################################################################-  29
;0030-################################################################################################################################-  30
;0031-################################################################################################################################-  31
;     |         |         |         |         |         |         |         |         |         |         |         |         |       
;                                                                                                         1                           
;               1         2         3         4         5         6         7         8         9         0         1         2       
;     01234567890123456789012345678901234567890123456789012345678901234567890123456789012345678901234567890123456789012345678901234567

;( IMAGE DATA )

BMP_Logo:

	;+------------+
	;| BMP Header |
	;+------------+
	.DW      1 ;Bits Color Bit
	.DW    128 ;Width Pixels
	.DW     32 ;Height Pixels
	.DW     16 ;Width Bytes 
	.DW    512 ;Size Bytes
	;+------------+
	;|  BMP Data  |
	;+------------+
	.DB 0x00,0x00,0x00,0x00,0x00,0x00,0x00,0x00,0x00,0x00,0x00,0x00,0x00,0x00,0x00,0x00;    0
	.DB 0x00,0x00,0x00,0x00,0x00,0x00,0x00,0x00,0x00,0x00,0x00,0x00,0x00,0x00,0x00,0x00;    1
	.DB 0x00,0x00,0x00,0x00,0x00,0x00,0x00,0x00,0x00,0x00,0x00,0x00,0x00,0x00,0x00,0x00;    2
	.DB 0x00,0x00,0x00,0x00,0x00,0x00,0x00,0x00,0x00,0x00,0x00,0x00,0x00,0x00,0x00,0x00;    3
	.DB 0x00,0x00,0x00,0x00,0x00,0x00,0x00,0x00,0x00,0x00,0x00,0x00,0x00,0x00,0x00,0x00;    4
	.DB 0x00,0x00,0x00,0x00,0x00,0x00,0x00,0x00,0x00,0x00,0x00,0x00,0x00,0x00,0x00,0x00;    5
	.DB 0x00,0x00,0x00,0x00,0x00,0x00,0x00,0x00,0x00,0x00,0x00,0x00,0x00,0x00,0x00,0x00;    6
	.DB 0x00,0x00,0x00,0x00,0x00,0x00,0x00,0x00,0x00,0x00,0x00,0x00,0x00,0x00,0x00,0x00;    7
	.DB 0x03,0xFF,0xF3,0xF8,0x07,0x7F,0xFF,0xC3,0xF3,0xE0,0x03,0x87,0xFF,0xE0,0x01,0xC0;    8
	.DB 0x07,0xFF,0xF3,0xF0,0x06,0x7F,0xFF,0xC7,0xF3,0xF8,0x03,0x1F,0xFF,0xC0,0x07,0x40;    9
	.DB 0x1F,0xC0,0x07,0xF0,0x0E,0xFE,0x0F,0xC7,0xE7,0xFE,0x07,0x3F,0x80,0x00,0x0E,0x60;    10
	.DB 0x1F,0xC0,0x07,0xE0,0x0C,0xFC,0x1F,0xC7,0xE7,0xFF,0x87,0x7F,0x00,0x00,0x1E,0xF0;    11
	.DB 0x3F,0x80,0x0F,0xE0,0x1D,0xFD,0xFF,0x8F,0xCF,0xFF,0xEE,0x7F,0x07,0xC0,0x7E,0xF0;    12
	.DB 0x3F,0x80,0x0F,0xC0,0x19,0xF9,0xFC,0x0F,0xCF,0xFF,0xFE,0xFE,0x0F,0xC0,0xFC,0xF8;    13
	.DB 0x7F,0x00,0x1F,0xC0,0x39,0xF8,0xFC,0x1F,0x9C,0x7F,0xFC,0xFE,0x0F,0x83,0xFC,0xF8;    14
	.DB 0x7F,0x00,0x1F,0xC0,0x73,0xF0,0xFE,0x1F,0x9C,0x1F,0xFC,0xFC,0x1F,0x87,0xF8,0xFC;    15
	.DB 0x7F,0x00,0x1F,0xC0,0xE3,0xF0,0x7E,0x3F,0x38,0x07,0xF8,0xFE,0x1F,0x1F,0xF8,0xFC;    16
	.DB 0x3F,0xFF,0x1F,0xFF,0xC7,0xE0,0x7F,0x3F,0x38,0x00,0xF8,0xFF,0xFF,0x3F,0xF0,0xFE;    17
	.DB 0x1F,0xFF,0x07,0xFE,0x07,0xE0,0x3F,0x3E,0x30,0x00,0x30,0x3F,0xFE,0x7F,0xF0,0xFE;    18
	.DB 0x00,0x00,0x00,0x00,0x00,0x00,0x00,0x00,0x00,0x00,0x00,0x00,0x00,0x00,0x00,0x00;    19
	.DB 0x1F,0x00,0x03,0x0E,0xE0,0x00,0x00,0x00,0x00,0x00,0x00,0x00,0x0F,0xE7,0xF0,0xFC;    20
	.DB 0x7F,0xB0,0x07,0x9F,0xE0,0x00,0x00,0x00,0x00,0x00,0x00,0x00,0x10,0x04,0x09,0x00;    21
	.DB 0x60,0x30,0x07,0x83,0x00,0x00,0x00,0x00,0x00,0x00,0x00,0x00,0x23,0xC7,0xF9,0xFC;    22
	.DB 0x6E,0x30,0x0C,0xC3,0x00,0x00,0x00,0x00,0x00,0x00,0x00,0x00,0x20,0x24,0x00,0x02;    23
	.DB 0x60,0x30,0x08,0xC3,0x00,0x00,0x00,0x00,0x00,0x00,0x00,0x00,0x1F,0xE0,0x01,0xFE;    24
	.DB 0x60,0x38,0x1B,0xE3,0x00,0x00,0x00,0x00,0x00,0x00,0x00,0x00,0x00,0x00,0x00,0x00;    25
	.DB 0x60,0x1F,0x90,0x33,0x00,0x00,0x00,0x00,0x00,0x00,0x00,0x00,0x00,0x00,0x00,0x00;    26
	.DB 0x00,0x00,0x00,0x00,0x00,0x00,0x00,0x00,0x00,0x00,0x00,0x00,0x00,0x00,0x00,0x00;    27
	.DB 0x00,0x00,0x00,0x00,0x00,0x00,0x00,0x00,0x00,0x00,0x00,0x00,0x00,0x00,0x00,0x00;    28
	.DB 0x00,0x00,0x00,0x00,0x00,0x00,0x00,0x00,0x00,0x00,0x00,0x00,0x00,0x00,0x00,0x00;    29
	.DB 0x00,0x00,0x00,0x00,0x00,0x00,0x00,0x00,0x00,0x00,0x00,0x00,0x00,0x00,0x00,0x00;    30
	.DB 0x00,0x00,0x00,0x00,0x00,0x00,0x00,0x00,0x00,0x00,0x00,0x00,0x00,0x00,0x00,0x00;    31
