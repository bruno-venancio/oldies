;+------------------------------------------------------
;| Generate Assembler File for Atmel AVR Studio 4..7
;|
;| Source
;|     Path : C:\Users\thiago\Desktop\
;|     File : Procurando Satelites_00001.jpg
;|
;| Destiny
;|     Path : C:\Users\thiago\Desktop\
;|     File : BMP_Procurando Satelites_00001.INC
;|
;| Destiny Image Properties
;|     Size   :  1024 Bytes
;|     Width  :   128 Pixels
;|     Height :    64 Pixels
;|     WidthB :    16 Bytes
;|     Colors :     2 Levels(1) Bit
;+------------------------------------------------------

;( IMAGE CONTENTS )

;                                                                                                         1                           
;               1         2         3         4         5         6         7         8         9         0         1         2       
;     01234567890123456789012345678901234567890123456789012345678901234567890123456789012345678901234567890123456789012345678901234567
;     |         |         |         |         |         |         |         |         |         |         |         |         |       
;0000-################################################################################################################################-   0
;0001-#                                                                                                                              #-   1
;0002-#                                                                                                                              #-   2
;0003-#                                                                                                                              #-   3
;0004-#                                                                                                                              #-   4
;0005-#                                                                                                                              #-   5
;0006-#                                                                                                                              #-   6
;0007-#                                                                                                                              #-   7
;0008-#                                                                                                                              #-   8
;0009-#                                                                                                                              #-   9
;0010-#                                                                                       ###                                    #-  10
;0011-#                                                                                      #####                                   #-  11
;0012-#                                                                                     #######                                  #-  12
;0013-#                                                                                    #########                                 #-  13
;0014-#                                                                                    ##########                                #-  14
;0015-#                                                                                     ##########                               #-  15
;0016-#                                                                                      ##########                              #-  16
;0017-#                                                                                       ##########                             #-  17
;0018-#                                                                                        ##########                            #-  18
;0019-#                                                                                         ##########                           #-  19
;0020-#                                                                                          #########     ######                #-  20
;0021-#                                                                                           #######     #########              #-  21
;0022-#      ####   ####    ###     ###   #   #  ####     ##   ##   #  ####    ###                 #####     ###########             #-  22
;0023-#      ##### ######  ######  #####  #   #  ######   ##   ##   # ######  ######                ####    ############             #-  23
;0024-#      #   # ##   # ##   ## ##   #  #   #  #   ##  ####  ###  # ##   #  #    #                 ##    #####    #####            #-  24
;0025-#      ##### ###### ##    # ##      #   #  #####   # ##  #### # ##   # ##    #                       #####     ####            #-  25
;0026-#      ####  #####  ##    # ##      #   #  ####   ## ##  ## ### ##   # ##    #                      ######     ####            #-  26
;0027-#      #     ##  ##  #   ## ##   #  #   #  #  ##  ###### ## ### ##   #  #   ##                     #######     ####            #-  27
;0028-#      #     ##  ##  #####   #####  #####  #   ## #   ## ##  ## ######  ######                     ########   #####            #-  28
;0029-#      #          #    ##     ##     ###   #    # #    #      #  ###      ##                      ################             #-  29
;0030-#                                                                                                 ###############              #-  30
;0031-#                                                                                                 ##############               #-  31
;0032-#                                                                                                ##############                #-  32
;0033-#                                  #                                                             #############                 #-  33
;0034-#                                 ##                                                      ###    ###########                   #-  34
;0035-#             ###     #   #####  ##### #     #  ##### #####   ###                        ####   ###########      ###           #-  35
;0036-#            ## ##   ###  ##### #####  ##    ## ##### #####  #####                       ####   #########       #####          #-  36
;0037-#            ##      ###    #   ##     ##    ##   #   ##     #                           ####   ######        ########         #-  37
;0038-#             ###    # ##   #   #####  ##    ##   #   #####  ####                        ####   ###          ##########        #-  38
;0039-#               ##  ## ##   #   ##     ##    ##   #   ##       ###                       ####                 ##########       #-  39
;0040-#            #   ## ######  #   ##     ##    ##   #   ##     #   #                        ####                 ##########      #-  40
;0041-#            ##### ##   ##  #   ###### ##### ##   #   #####  #####                        #####   ##            ##########     #-  41
;0042-#              ##        #  #    #####  ####      #   #####   ###   #  #                   ##########            ##########    #-  42
;0043-#                                                                                           #########             ##########   #-  43
;0044-#                                                                                             ######               ##########  #-  44
;0045-#                                                                                                                   #########  #-  45
;0046-#                                                                                                                    #######   #-  46
;0047-#                                                                                                                     #####    #-  47
;0048-#                                                                                                                      ###     #-  48
;0049-#                                                                                                                       #      #-  49
;0050-#                                                                                                                              #-  50
;0051-#                                                                                                                              #-  51
;0052-#                                                                                                                              #-  52
;0053-#                                                                                                                              #-  53
;0054-#                                                                                                                              #-  54
;0055-#                                                                                                                              #-  55
;0056-#                                                                                                                              #-  56
;0057-#                                                                                                                              #-  57
;0058-#                                                                                                                              #-  58
;0059-#                                                                                                                              #-  59
;0060-#                                                                                                                              #-  60
;0061-#                                                                                                                              #-  61
;0062-#                                                                                                                              #-  62
;0063-################################################################################################################################-  63
;     |         |         |         |         |         |         |         |         |         |         |         |         |       
;                                                                                                         1                           
;               1         2         3         4         5         6         7         8         9         0         1         2       
;     01234567890123456789012345678901234567890123456789012345678901234567890123456789012345678901234567890123456789012345678901234567

;( IMAGE DATA )

PROC_SAT_2:

	;+------------+
	;| BMP Header |
	;+------------+
	.DW      1 ;Bits Color Bit
	.DW    128 ;Width Pixels
	.DW     64 ;Height Pixels
	.DW     16 ;Width Bytes 
	.DW   1024 ;Size Bytes
	;+------------+
	;|  BMP Data  |
	;+------------+
	.DB 0x00,0x00,0x00,0x00,0x00,0x00,0x00,0x00,0x00,0x00,0x00,0x00,0x00,0x00,0x00,0x00;    0
	.DB 0x7F,0xFF,0xFF,0xFF,0xFF,0xFF,0xFF,0xFF,0xFF,0xFF,0xFF,0xFF,0xFF,0xFF,0xFF,0xFE;    1
	.DB 0x7F,0xFF,0xFF,0xFF,0xFF,0xFF,0xFF,0xFF,0xFF,0xFF,0xFF,0xFF,0xFF,0xFF,0xFF,0xFE;    2
	.DB 0x7F,0xFF,0xFF,0xFF,0xFF,0xFF,0xFF,0xFF,0xFF,0xFF,0xFF,0xFF,0xFF,0xFF,0xFF,0xFE;    3
	.DB 0x7F,0xFF,0xFF,0xFF,0xFF,0xFF,0xFF,0xFF,0xFF,0xFF,0xFF,0xFF,0xFF,0xFF,0xFF,0xFE;    4
	.DB 0x7F,0xFF,0xFF,0xFF,0xFF,0xFF,0xFF,0xFF,0xFF,0xFF,0xFF,0xFF,0xFF,0xFF,0xFF,0xFE;    5
	.DB 0x7F,0xFF,0xFF,0xFF,0xFF,0xFF,0xFF,0xFF,0xFF,0xFF,0xFF,0xFF,0xFF,0xFF,0xFF,0xFE;    6
	.DB 0x7F,0xFF,0xFF,0xFF,0xFF,0xFF,0xFF,0xFF,0xFF,0xFF,0xFF,0xFF,0xFF,0xFF,0xFF,0xFE;    7
	.DB 0x7F,0xFF,0xFF,0xFF,0xFF,0xFF,0xFF,0xFF,0xFF,0xFF,0xFF,0xFF,0xFF,0xFF,0xFF,0xFE;    8
	.DB 0x7F,0xFF,0xFF,0xFF,0xFF,0xFF,0xFF,0xFF,0xFF,0xFF,0xFF,0xFF,0xFF,0xFF,0xFF,0xFE;    9
	.DB 0x7F,0xFF,0xFF,0xFF,0xFF,0xFF,0xFF,0xFF,0xFF,0xFF,0xFF,0x1F,0xFF,0xFF,0xFF,0xFE;    10
	.DB 0x7F,0xFF,0xFF,0xFF,0xFF,0xFF,0xFF,0xFF,0xFF,0xFF,0xFE,0x0F,0xFF,0xFF,0xFF,0xFE;    11
	.DB 0x7F,0xFF,0xFF,0xFF,0xFF,0xFF,0xFF,0xFF,0xFF,0xFF,0xFC,0x07,0xFF,0xFF,0xFF,0xFE;    12
	.DB 0x7F,0xFF,0xFF,0xFF,0xFF,0xFF,0xFF,0xFF,0xFF,0xFF,0xF8,0x03,0xFF,0xFF,0xFF,0xFE;    13
	.DB 0x7F,0xFF,0xFF,0xFF,0xFF,0xFF,0xFF,0xFF,0xFF,0xFF,0xF8,0x01,0xFF,0xFF,0xFF,0xFE;    14
	.DB 0x7F,0xFF,0xFF,0xFF,0xFF,0xFF,0xFF,0xFF,0xFF,0xFF,0xFC,0x00,0xFF,0xFF,0xFF,0xFE;    15
	.DB 0x7F,0xFF,0xFF,0xFF,0xFF,0xFF,0xFF,0xFF,0xFF,0xFF,0xFE,0x00,0x7F,0xFF,0xFF,0xFE;    16
	.DB 0x7F,0xFF,0xFF,0xFF,0xFF,0xFF,0xFF,0xFF,0xFF,0xFF,0xFF,0x00,0x3F,0xFF,0xFF,0xFE;    17
	.DB 0x7F,0xFF,0xFF,0xFF,0xFF,0xFF,0xFF,0xFF,0xFF,0xFF,0xFF,0x80,0x1F,0xFF,0xFF,0xFE;    18
	.DB 0x7F,0xFF,0xFF,0xFF,0xFF,0xFF,0xFF,0xFF,0xFF,0xFF,0xFF,0xC0,0x0F,0xFF,0xFF,0xFE;    19
	.DB 0x7F,0xFF,0xFF,0xFF,0xFF,0xFF,0xFF,0xFF,0xFF,0xFF,0xFF,0xE0,0x0F,0x81,0xFF,0xFE;    20
	.DB 0x7F,0xFF,0xFF,0xFF,0xFF,0xFF,0xFF,0xFF,0xFF,0xFF,0xFF,0xF0,0x1F,0x00,0x7F,0xFE;    21
	.DB 0x7E,0x1C,0x3C,0x7C,0x77,0x61,0xF3,0x9D,0x87,0x8F,0xFF,0xF8,0x3E,0x00,0x3F,0xFE;    22
	.DB 0x7E,0x08,0x18,0x18,0x37,0x60,0x73,0x9D,0x03,0x03,0xFF,0xFC,0x3C,0x00,0x3F,0xFE;    23
	.DB 0x7E,0xE9,0xD3,0x93,0xB7,0x6E,0x61,0x8D,0x3B,0x7B,0xFF,0xFE,0x78,0x3C,0x1F,0xFE;    24
	.DB 0x7E,0x08,0x13,0xD3,0xF7,0x60,0xE9,0x85,0x3A,0x7B,0xFF,0xFF,0xF8,0x3E,0x1F,0xFE;    25
	.DB 0x7E,0x18,0x33,0xD3,0xF7,0x61,0xC9,0x91,0x3A,0x7B,0xFF,0xFF,0xF0,0x3E,0x1F,0xFE;    26
	.DB 0x7E,0xF9,0x9B,0x93,0xB7,0x6C,0xC0,0x91,0x3B,0x73,0xFF,0xFF,0xE0,0x3E,0x1F,0xFE;    27
	.DB 0x7E,0xF9,0x98,0x38,0x30,0x6E,0x5C,0x99,0x03,0x03,0xFF,0xFF,0xE0,0x1C,0x1F,0xFE;    28
	.DB 0x7E,0xFF,0xDE,0x7C,0xF8,0xEF,0x5E,0xFD,0x8F,0xCF,0xFF,0xFF,0xC0,0x00,0x3F,0xFE;    29
	.DB 0x7F,0xFF,0xFF,0xFF,0xFF,0xFF,0xFF,0xFF,0xFF,0xFF,0xFF,0xFF,0xC0,0x00,0x7F,0xFE;    30
	.DB 0x7F,0xFF,0xFF,0xFF,0xFF,0xFF,0xFF,0xFF,0xFF,0xFF,0xFF,0xFF,0xC0,0x00,0xFF,0xFE;    31
	.DB 0x7F,0xFF,0xFF,0xFF,0xFF,0xFF,0xFF,0xFF,0xFF,0xFF,0xFF,0xFF,0x80,0x01,0xFF,0xFE;    32
	.DB 0x7F,0xFF,0xFF,0xFF,0xEF,0xFF,0xFF,0xFF,0xFF,0xFF,0xFF,0xFF,0x80,0x03,0xFF,0xFE;    33
	.DB 0x7F,0xFF,0xFF,0xFF,0xCF,0xFF,0xFF,0xFF,0xFF,0xFF,0xFF,0xC7,0x80,0x0F,0xFF,0xFE;    34
	.DB 0x7F,0xFC,0x7D,0xC1,0x82,0xFB,0x04,0x1C,0x7F,0xFF,0xFF,0x87,0x00,0x1F,0x8F,0xFE;    35
	.DB 0x7F,0xF9,0x38,0xC1,0x06,0x79,0x04,0x18,0x3F,0xFF,0xFF,0x87,0x00,0x7F,0x07,0xFE;    36
	.DB 0x7F,0xF9,0xF8,0xF7,0x3E,0x79,0xDC,0xFB,0xFF,0xFF,0xFF,0x87,0x03,0xFC,0x03,0xFE;    37
	.DB 0x7F,0xFC,0x7A,0x77,0x06,0x79,0xDC,0x18,0x7F,0xFF,0xFF,0x87,0x1F,0xF8,0x01,0xFE;    38
	.DB 0x7F,0xFF,0x32,0x77,0x3E,0x79,0xDC,0xFE,0x3F,0xFF,0xFF,0x87,0xFF,0xFC,0x00,0xFE;    39
	.DB 0x7F,0xFB,0x90,0x37,0x3E,0x79,0xDC,0xFB,0xBF,0xFF,0xFF,0xC3,0xFF,0xFE,0x00,0x7E;    40
	.DB 0x7F,0xF8,0x27,0x37,0x02,0x09,0xDC,0x18,0x3F,0xFF,0xFF,0xC1,0xCF,0xFF,0x00,0x3E;    41
	.DB 0x7F,0xFE,0x7F,0xB7,0x83,0x0F,0xDC,0x1C,0x76,0xFF,0xFF,0xE0,0x07,0xFF,0x80,0x1E;    42
	.DB 0x7F,0xFF,0xFF,0xFF,0xFF,0xFF,0xFF,0xFF,0xFF,0xFF,0xFF,0xF0,0x07,0xFF,0xC0,0x0E;    43
	.DB 0x7F,0xFF,0xFF,0xFF,0xFF,0xFF,0xFF,0xFF,0xFF,0xFF,0xFF,0xFC,0x0F,0xFF,0xE0,0x06;    44
	.DB 0x7F,0xFF,0xFF,0xFF,0xFF,0xFF,0xFF,0xFF,0xFF,0xFF,0xFF,0xFF,0xFF,0xFF,0xF0,0x06;    45
	.DB 0x7F,0xFF,0xFF,0xFF,0xFF,0xFF,0xFF,0xFF,0xFF,0xFF,0xFF,0xFF,0xFF,0xFF,0xF8,0x0E;    46
	.DB 0x7F,0xFF,0xFF,0xFF,0xFF,0xFF,0xFF,0xFF,0xFF,0xFF,0xFF,0xFF,0xFF,0xFF,0xFC,0x1E;    47
	.DB 0x7F,0xFF,0xFF,0xFF,0xFF,0xFF,0xFF,0xFF,0xFF,0xFF,0xFF,0xFF,0xFF,0xFF,0xFE,0x3E;    48
	.DB 0x7F,0xFF,0xFF,0xFF,0xFF,0xFF,0xFF,0xFF,0xFF,0xFF,0xFF,0xFF,0xFF,0xFF,0xFF,0x7E;    49
	.DB 0x7F,0xFF,0xFF,0xFF,0xFF,0xFF,0xFF,0xFF,0xFF,0xFF,0xFF,0xFF,0xFF,0xFF,0xFF,0xFE;    50
	.DB 0x7F,0xFF,0xFF,0xFF,0xFF,0xFF,0xFF,0xFF,0xFF,0xFF,0xFF,0xFF,0xFF,0xFF,0xFF,0xFE;    51
	.DB 0x7F,0xFF,0xFF,0xFF,0xFF,0xFF,0xFF,0xFF,0xFF,0xFF,0xFF,0xFF,0xFF,0xFF,0xFF,0xFE;    52
	.DB 0x7F,0xFF,0xFF,0xFF,0xFF,0xFF,0xFF,0xFF,0xFF,0xFF,0xFF,0xFF,0xFF,0xFF,0xFF,0xFE;    53
	.DB 0x7F,0xFF,0xFF,0xFF,0xFF,0xFF,0xFF,0xFF,0xFF,0xFF,0xFF,0xFF,0xFF,0xFF,0xFF,0xFE;    54
	.DB 0x7F,0xFF,0xFF,0xFF,0xFF,0xFF,0xFF,0xFF,0xFF,0xFF,0xFF,0xFF,0xFF,0xFF,0xFF,0xFE;    55
	.DB 0x7F,0xFF,0xFF,0xFF,0xFF,0xFF,0xFF,0xFF,0xFF,0xFF,0xFF,0xFF,0xFF,0xFF,0xFF,0xFE;    56
	.DB 0x7F,0xFF,0xFF,0xFF,0xFF,0xFF,0xFF,0xFF,0xFF,0xFF,0xFF,0xFF,0xFF,0xFF,0xFF,0xFE;    57
	.DB 0x7F,0xFF,0xFF,0xFF,0xFF,0xFF,0xFF,0xFF,0xFF,0xFF,0xFF,0xFF,0xFF,0xFF,0xFF,0xFE;    58
	.DB 0x7F,0xFF,0xFF,0xFF,0xFF,0xFF,0xFF,0xFF,0xFF,0xFF,0xFF,0xFF,0xFF,0xFF,0xFF,0xFE;    59
	.DB 0x7F,0xFF,0xFF,0xFF,0xFF,0xFF,0xFF,0xFF,0xFF,0xFF,0xFF,0xFF,0xFF,0xFF,0xFF,0xFE;    60
	.DB 0x7F,0xFF,0xFF,0xFF,0xFF,0xFF,0xFF,0xFF,0xFF,0xFF,0xFF,0xFF,0xFF,0xFF,0xFF,0xFE;    61
	.DB 0x7F,0xFF,0xFF,0xFF,0xFF,0xFF,0xFF,0xFF,0xFF,0xFF,0xFF,0xFF,0xFF,0xFF,0xFF,0xFE;    62
	.DB 0x00,0x00,0x00,0x00,0x00,0x00,0x00,0x00,0x00,0x00,0x00,0x00,0x00,0x00,0x00,0x00;    63
