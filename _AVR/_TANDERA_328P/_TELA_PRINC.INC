;+------------------------------------------------
;| Generate Assembler File for Atmel AVR Studio 4..7
;|
;| Source
;|     Path : C:\Users\thiago\Desktop\
;|     File : Tela principal_00000.jpg
;|
;| Destiny
;|     Path : C:\Users\thiago\Desktop\
;|     File : BMP_Tela principal_00000.INC
;|
;| Destiny Image Properties
;|     Size   :  1024 Bytes
;|     Width  :   128 Pixels
;|     Height :    64 Pixels
;|     WidthB :    16 Bytes
;|     Colors :     2 Levels(1) Bit
;+------------------------------------------------

;( IMAGE CONTENTS )

;                                                                                                         1                           
;               1         2         3         4         5         6         7         8         9         0         1         2       
;     01234567890123456789012345678901234567890123456789012345678901234567890123456789012345678901234567890123456789012345678901234567
;     |         |         |         |         |         |         |         |         |         |         |         |         |       
;0000- #       #                                             ##################                                                 #     -   0
;0001-  #     #                                              #                #                                                # #    -   1
;0002-   #   #                                               # ############## #                                               #   #   -   2
;0003-    ###                                                #                #                                              #     #  -   3
;0004- #   #   #                                             # ############## #                                             #   #   # -   4
;0005-  #     #                                              #                #                                                # #    -   5
;0006-   #   #                                               # ############## #                                               #   #   -   6
;0007-    ###                                                #                #                                              #     #  -   7
;0008-     #                                                 ##################                                             #       # -   8
;0009-                                                                                                                                -   9
;0010-                                                                                                                                -  10
;0011-                                                                                                                                -  11
;0012-                                                                                                                                -  12
;0013-                                                                                                                                -  13
;0014-                                                                                                                                -  14
;0015-                                                                                                                                -  15
;0016-                                                                                                                                -  16
;0017-                                                                                                                                -  17
;0018-                                                                                                                                -  18
;0019-                                                                                                                                -  19
;0020-                                                                                                                                -  20
;0021-                                                                                                                                -  21
;0022-                                                                                                                                -  22
;0023-                                                                                                                                -  23
;0024-                                                                                                                                -  24
;0025-                                                                                                                                -  25
;0026-                                                                                                                                -  26
;0027-                                                                                                                                -  27
;0028-                                                                                                                                -  28
;0029-                                                                                                                                -  29
;0030-                                                                                                                                -  30
;0031-                                                                                                                                -  31
;0032-                                                                                                                                -  32
;0033-                                                                                                                                -  33
;0034-                                                                                                                                -  34
;0035-                                                                                                                                -  35
;0036-                                                                                                                                -  36
;0037-                                                                                                                                -  37
;0038-                                                                                                                                -  38
;0039-                                                                                                                                -  39
;0040-                                                                                                                                -  40
;0041-                                                                                                                                -  41
;0042-                                                                                                                                -  42
;0043-                                                                                                                                -  43
;0044-                                                                                                                                -  44
;0045-                                                                                                                                -  45
;0046-                                                                                                                                -  46
;0047-                                                                                                                                -  47
;0048-                                                                                                                                -  48
;0049-                                                                    ##                                                          -  49
;0050-                                                                    ###                                                         -  50
;0051-                                                                     ###                                                        -  51
;0052-                                                                      ###  ##                                                   -  52
;0053-                                                                       #  ####                                                  -  53
;0054-                                                                         ##  #                                                  -  54
;0055-                                                                         #####                                                  -  55
;0056-                                                                   ##   #####                                                   -  56
;0057-                                                                   #  # ####                                                    -  57
;0058-                                                                   # ## ##   ##                                                 -  58
;0059-                                                                   ## #      ###                                                -  59
;0060-                                                                    # ###     ###                                               -  60
;0061-                                                                    ##         ###                                              -  61
;0062-                                                                     ######     #                                               -  62
;0063-                                                                                                                                -  63
;     |         |         |         |         |         |         |         |         |         |         |         |         |       
;                                                                                                         1                           
;               1         2         3         4         5         6         7         8         9         0         1         2       
;     01234567890123456789012345678901234567890123456789012345678901234567890123456789012345678901234567890123456789012345678901234567

;( IMAGE DATA )

TELA_PRINCIPAL:

	;+------------+
	;| BMP Header |
	;+------------+
	.DW      1 ;Bits Color Bit
	.DW    128 ;Width Pixels
	.DW     64 ;Height Pixels
	.DW     16 ;Width Bytes 
	.DW   1024 ;Size Bytes
	;+------------+
	;|  BMP Data  |
	;+------------+
	.DB 0xBF,0xBF,0xFF,0xFF,0xFF,0xFF,0xFE,0x00,0x00,0x7F,0xFF,0xFF,0xFF,0xFF,0xFF,0xDF;    0
	.DB 0xDF,0x7F,0xFF,0xFF,0xFF,0xFF,0xFE,0xFF,0xFF,0x7F,0xFF,0xFF,0xFF,0xFF,0xFF,0xAF;    1
	.DB 0xEE,0xFF,0xFF,0xFF,0xFF,0xFF,0xFE,0x80,0x01,0x7F,0xFF,0xFF,0xFF,0xFF,0xFF,0x77;    2
	.DB 0xF1,0xFF,0xFF,0xFF,0xFF,0xFF,0xFE,0xFF,0xFF,0x7F,0xFF,0xFF,0xFF,0xFF,0xFE,0xFB;    3
	.DB 0xBB,0xBF,0xFF,0xFF,0xFF,0xFF,0xFE,0x80,0x01,0x7F,0xFF,0xFF,0xFF,0xFF,0xFD,0xDD;    4
	.DB 0xDF,0x7F,0xFF,0xFF,0xFF,0xFF,0xFE,0xFF,0xFF,0x7F,0xFF,0xFF,0xFF,0xFF,0xFF,0xAF;    5
	.DB 0xEE,0xFF,0xFF,0xFF,0xFF,0xFF,0xFE,0x80,0x01,0x7F,0xFF,0xFF,0xFF,0xFF,0xFF,0x77;    6
	.DB 0xF1,0xFF,0xFF,0xFF,0xFF,0xFF,0xFE,0xFF,0xFF,0x7F,0xFF,0xFF,0xFF,0xFF,0xFE,0xFB;    7
	.DB 0xFB,0xFF,0xFF,0xFF,0xFF,0xFF,0xFE,0x00,0x00,0x7F,0xFF,0xFF,0xFF,0xFF,0xFD,0xFD;    8
	.DB 0xFF,0xFF,0xFF,0xFF,0xFF,0xFF,0xFF,0xFF,0xFF,0xFF,0xFF,0xFF,0xFF,0xFF,0xFF,0xFF;    9
	.DB 0xFF,0xFF,0xFF,0xFF,0xFF,0xFF,0xFF,0xFF,0xFF,0xFF,0xFF,0xFF,0xFF,0xFF,0xFF,0xFF;    10
	.DB 0xFF,0xFF,0xFF,0xFF,0xFF,0xFF,0xFF,0xFF,0xFF,0xFF,0xFF,0xFF,0xFF,0xFF,0xFF,0xFF;    11
	.DB 0xFF,0xFF,0xFF,0xFF,0xFF,0xFF,0xFF,0xFF,0xFF,0xFF,0xFF,0xFF,0xFF,0xFF,0xFF,0xFF;    12
	.DB 0xFF,0xFF,0xFF,0xFF,0xFF,0xFF,0xFF,0xFF,0xFF,0xFF,0xFF,0xFF,0xFF,0xFF,0xFF,0xFF;    13
	.DB 0xFF,0xFF,0xFF,0xFF,0xFF,0xFF,0xFF,0xFF,0xFF,0xFF,0xFF,0xFF,0xFF,0xFF,0xFF,0xFF;    14
	.DB 0xFF,0xFF,0xFF,0xFF,0xFF,0xFF,0xFF,0xFF,0xFF,0xFF,0xFF,0xFF,0xFF,0xFF,0xFF,0xFF;    15
	.DB 0xFF,0xFF,0xFF,0xFF,0xFF,0xFF,0xFF,0xFF,0xFF,0xFF,0xFF,0xFF,0xFF,0xFF,0xFF,0xFF;    16
	.DB 0xFF,0xFF,0xFF,0xFF,0xFF,0xFF,0xFF,0xFF,0xFF,0xFF,0xFF,0xFF,0xFF,0xFF,0xFF,0xFF;    17
	.DB 0xFF,0xFF,0xFF,0xFF,0xFF,0xFF,0xFF,0xFF,0xFF,0xFF,0xFF,0xFF,0xFF,0xFF,0xFF,0xFF;    18
	.DB 0xFF,0xFF,0xFF,0xFF,0xFF,0xFF,0xFF,0xFF,0xFF,0xFF,0xFF,0xFF,0xFF,0xFF,0xFF,0xFF;    19
	.DB 0xFF,0xFF,0xFF,0xFF,0xFF,0xFF,0xFF,0xFF,0xFF,0xFF,0xFF,0xFF,0xFF,0xFF,0xFF,0xFF;    20
	.DB 0xFF,0xFF,0xFF,0xFF,0xFF,0xFF,0xFF,0xFF,0xFF,0xFF,0xFF,0xFF,0xFF,0xFF,0xFF,0xFF;    21
	.DB 0xFF,0xFF,0xFF,0xFF,0xFF,0xFF,0xFF,0xFF,0xFF,0xFF,0xFF,0xFF,0xFF,0xFF,0xFF,0xFF;    22
	.DB 0xFF,0xFF,0xFF,0xFF,0xFF,0xFF,0xFF,0xFF,0xFF,0xFF,0xFF,0xFF,0xFF,0xFF,0xFF,0xFF;    23
	.DB 0xFF,0xFF,0xFF,0xFF,0xFF,0xFF,0xFF,0xFF,0xFF,0xFF,0xFF,0xFF,0xFF,0xFF,0xFF,0xFF;    24
	.DB 0xFF,0xFF,0xFF,0xFF,0xFF,0xFF,0xFF,0xFF,0xFF,0xFF,0xFF,0xFF,0xFF,0xFF,0xFF,0xFF;    25
	.DB 0xFF,0xFF,0xFF,0xFF,0xFF,0xFF,0xFF,0xFF,0xFF,0xFF,0xFF,0xFF,0xFF,0xFF,0xFF,0xFF;    26
	.DB 0xFF,0xFF,0xFF,0xFF,0xFF,0xFF,0xFF,0xFF,0xFF,0xFF,0xFF,0xFF,0xFF,0xFF,0xFF,0xFF;    27
	.DB 0xFF,0xFF,0xFF,0xFF,0xFF,0xFF,0xFF,0xFF,0xFF,0xFF,0xFF,0xFF,0xFF,0xFF,0xFF,0xFF;    28
	.DB 0xFF,0xFF,0xFF,0xFF,0xFF,0xFF,0xFF,0xFF,0xFF,0xFF,0xFF,0xFF,0xFF,0xFF,0xFF,0xFF;    29
	.DB 0xFF,0xFF,0xFF,0xFF,0xFF,0xFF,0xFF,0xFF,0xFF,0xFF,0xFF,0xFF,0xFF,0xFF,0xFF,0xFF;    30
	.DB 0xFF,0xFF,0xFF,0xFF,0xFF,0xFF,0xFF,0xFF,0xFF,0xFF,0xFF,0xFF,0xFF,0xFF,0xFF,0xFF;    31
	.DB 0xFF,0xFF,0xFF,0xFF,0xFF,0xFF,0xFF,0xFF,0xFF,0xFF,0xFF,0xFF,0xFF,0xFF,0xFF,0xFF;    32
	.DB 0xFF,0xFF,0xFF,0xFF,0xFF,0xFF,0xFF,0xFF,0xFF,0xFF,0xFF,0xFF,0xFF,0xFF,0xFF,0xFF;    33
	.DB 0xFF,0xFF,0xFF,0xFF,0xFF,0xFF,0xFF,0xFF,0xFF,0xFF,0xFF,0xFF,0xFF,0xFF,0xFF,0xFF;    34
	.DB 0xFF,0xFF,0xFF,0xFF,0xFF,0xFF,0xFF,0xFF,0xFF,0xFF,0xFF,0xFF,0xFF,0xFF,0xFF,0xFF;    35
	.DB 0xFF,0xFF,0xFF,0xFF,0xFF,0xFF,0xFF,0xFF,0xFF,0xFF,0xFF,0xFF,0xFF,0xFF,0xFF,0xFF;    36
	.DB 0xFF,0xFF,0xFF,0xFF,0xFF,0xFF,0xFF,0xFF,0xFF,0xFF,0xFF,0xFF,0xFF,0xFF,0xFF,0xFF;    37
	.DB 0xFF,0xFF,0xFF,0xFF,0xFF,0xFF,0xFF,0xFF,0xFF,0xFF,0xFF,0xFF,0xFF,0xFF,0xFF,0xFF;    38
	.DB 0xFF,0xFF,0xFF,0xFF,0xFF,0xFF,0xFF,0xFF,0xFF,0xFF,0xFF,0xFF,0xFF,0xFF,0xFF,0xFF;    39
	.DB 0xFF,0xFF,0xFF,0xFF,0xFF,0xFF,0xFF,0xFF,0xFF,0xFF,0xFF,0xFF,0xFF,0xFF,0xFF,0xFF;    40
	.DB 0xFF,0xFF,0xFF,0xFF,0xFF,0xFF,0xFF,0xFF,0xFF,0xFF,0xFF,0xFF,0xFF,0xFF,0xFF,0xFF;    41
	.DB 0xFF,0xFF,0xFF,0xFF,0xFF,0xFF,0xFF,0xFF,0xFF,0xFF,0xFF,0xFF,0xFF,0xFF,0xFF,0xFF;    42
	.DB 0xFF,0xFF,0xFF,0xFF,0xFF,0xFF,0xFF,0xFF,0xFF,0xFF,0xFF,0xFF,0xFF,0xFF,0xFF,0xFF;    43
	.DB 0xFF,0xFF,0xFF,0xFF,0xFF,0xFF,0xFF,0xFF,0xFF,0xFF,0xFF,0xFF,0xFF,0xFF,0xFF,0xFF;    44
	.DB 0xFF,0xFF,0xFF,0xFF,0xFF,0xFF,0xFF,0xFF,0xFF,0xFF,0xFF,0xFF,0xFF,0xFF,0xFF,0xFF;    45
	.DB 0xFF,0xFF,0xFF,0xFF,0xFF,0xFF,0xFF,0xFF,0xFF,0xFF,0xFF,0xFF,0xFF,0xFF,0xFF,0xFF;    46
	.DB 0xFF,0xFF,0xFF,0xFF,0xFF,0xFF,0xFF,0xFF,0xFF,0xFF,0xFF,0xFF,0xFF,0xFF,0xFF,0xFF;    47
	.DB 0xFF,0xFF,0xFF,0xFF,0xFF,0xFF,0xFF,0xFF,0xFF,0xFF,0xFF,0xFF,0xFF,0xFF,0xFF,0xFF;    48
	.DB 0xFF,0xFF,0xFF,0xFF,0xFF,0xFF,0xFF,0xFF,0xF3,0xFF,0xFF,0xFF,0xFF,0xFF,0xFF,0xFF;    49
	.DB 0xFF,0xFF,0xFF,0xFF,0xFF,0xFF,0xFF,0xFF,0xF1,0xFF,0xFF,0xFF,0xFF,0xFF,0xFF,0xFF;    50
	.DB 0xFF,0xFF,0xFF,0xFF,0xFF,0xFF,0xFF,0xFF,0xF8,0xFF,0xFF,0xFF,0xFF,0xFF,0xFF,0xFF;    51
	.DB 0xFF,0xFF,0xFF,0xFF,0xFF,0xFF,0xFF,0xFF,0xFC,0x67,0xFF,0xFF,0xFF,0xFF,0xFF,0xFF;    52
	.DB 0xFF,0xFF,0xFF,0xFF,0xFF,0xFF,0xFF,0xFF,0xFE,0xC3,0xFF,0xFF,0xFF,0xFF,0xFF,0xFF;    53
	.DB 0xFF,0xFF,0xFF,0xFF,0xFF,0xFF,0xFF,0xFF,0xFF,0x9B,0xFF,0xFF,0xFF,0xFF,0xFF,0xFF;    54
	.DB 0xFF,0xFF,0xFF,0xFF,0xFF,0xFF,0xFF,0xFF,0xFF,0x83,0xFF,0xFF,0xFF,0xFF,0xFF,0xFF;    55
	.DB 0xFF,0xFF,0xFF,0xFF,0xFF,0xFF,0xFF,0xFF,0xE7,0x07,0xFF,0xFF,0xFF,0xFF,0xFF,0xFF;    56
	.DB 0xFF,0xFF,0xFF,0xFF,0xFF,0xFF,0xFF,0xFF,0xED,0x0F,0xFF,0xFF,0xFF,0xFF,0xFF,0xFF;    57
	.DB 0xFF,0xFF,0xFF,0xFF,0xFF,0xFF,0xFF,0xFF,0xE9,0x39,0xFF,0xFF,0xFF,0xFF,0xFF,0xFF;    58
	.DB 0xFF,0xFF,0xFF,0xFF,0xFF,0xFF,0xFF,0xFF,0xE5,0xF8,0xFF,0xFF,0xFF,0xFF,0xFF,0xFF;    59
	.DB 0xFF,0xFF,0xFF,0xFF,0xFF,0xFF,0xFF,0xFF,0xF4,0x7C,0x7F,0xFF,0xFF,0xFF,0xFF,0xFF;    60
	.DB 0xFF,0xFF,0xFF,0xFF,0xFF,0xFF,0xFF,0xFF,0xF3,0xFE,0x3F,0xFF,0xFF,0xFF,0xFF,0xFF;    61
	.DB 0xFF,0xFF,0xFF,0xFF,0xFF,0xFF,0xFF,0xFF,0xF8,0x1F,0x7F,0xFF,0xFF,0xFF,0xFF,0xFF;    62
	.DB 0xFF,0xFF,0xFF,0xFF,0xFF,0xFF,0xFF,0xFF,0xFF,0xFF,0xFF,0xFF,0xFF,0xFF,0xFF,0xFF;    63
