/*
	#-------------------------------------------------------------------------------#
	|        _____ ___________  __   _____  _____  ____  ______          _			|
	|       /  ___/  ___|  _  \/  | |____ ||  _  |/ ___| |  ___|        | |			|
	|       \ `--.\ `--.| | | |`| |     / /| |/' / /___  | |_ ___  _ __ | |_		|
	|        `--. \`--. \ | | | | |     \ \|  /| | ___ \ |  _/ _ \| '_ \| __|		|
	|       /\__/ /\__/ / |/ / _| |_.___/ /\ |_/ / \_/ | | || (_) | | | | |_		|
	|       \____/\____/|___/  \___/\____/  \___/\_____/ \_| \___/|_| |_|\__|		|
	|																				|
	|																				|
	|                                _____      _____								|
	|                               |  ___|    |  _  |								|
	|                               |___ \__  __\ V /								|
	|                                   \ \ \/ // _ \								|
	|                               /\__/ />  <| |_| |								|
	|                               \____//_/\_\_____/								|
	|																				|
	|																				|
	#-------------------------------------------------------------------------------#
*/

//ENABLE BELOW LINE TO USE ONLY ASCII ' ' TO '~' IF NOT ENABLED USE ALL CHARACTERS 0X00 TO 0XFF


#define	 __ASCII_FONT__


.EQU	_SSD1306_FONT_WIDTH		= 6
.EQU	_SSD1306_FONT_HEIGHT	= 8

_SSD1306_FONT_5X8:
//
//if not defiend ascii font insert all characters 
//
#ifndef __ASCII_FONT__
// Character 'NULL' ASCII Code(0X0)--------------------------------
.db 0b00000000,\
    0b00000000
.db 0b00000000,\
    0b00000000
.db 0b00000000,\
    0b00000000
.db 0b00000000,\
    0b00000000
// Character	'SOH' ASCII Code(0X1)--------------------------------
.db 0b00111100,\
    0b01000010
.db 0b10100101,\
    0b10000001
.db 0b10100101,\
    0b10011001
.db 0b01000010,\
    0b00111100
// Character 'STX' ASCII Code(0X2)--------------------------------
.db 0b00111100,\
    0b01111110
.db 0b11011011,\
    0b11111111
.db 0b11111111,\
    0b11011011
.db 0b01100110,\
    0b00111100
// Character 'ETX' ASCII Code(0X3)--------------------------------
.db 0b01101100,\
    0b11111110
.db 0b11111110,\
    0b11111110
.db 0b01111100,\
    0b00111000
.db 0b00010000,\
    0b00000000
// Character 'EOT' ASCII Code(0X4)--------------------------------
.db 0b00010000,\
    0b00111000
.db 0b01111100,\
    0b11111110
.db 0b01111100,\
    0b00111000
.db 0b00010000,\
    0b00000000
// Character 'ENQ' ASCII Code(0X5)--------------------------------
.db 0b00010000,\
    0b00111000
.db 0b01010100,\
    0b11111110
.db 0b01010100,\
    0b00010000
.db 0b00111000,\
    0b00000000
// Character 'ACK' ASCII Code(0X6)--------------------------------
.db 0b00010000,\
    0b00111000
.db 0b01111100,\
    0b11111110
.db 0b11111110,\
    0b00010000
.db 0b00111000,\
    0b00000000
// Character 'BEL' ASCII Code(0X7)--------------------------------
.db 0b00000000,\
    0b00000000
.db 0b00000000,\
    0b00110000
.db 0b00110000,\
    0b00000000
.db 0b00000000,\
    0b00000000
// Character 'BS' ASCII Code(0X8)--------------------------------
.db 0b11111111,\
    0b11111111
.db 0b11111111,\
    0b11100111
.db 0b11100111,\
    0b11111111
.db 0b11111111,\
    0b11111111
// Character '0X09' ASCII Code(0X9)--------------------------------
.db 0b00111000,\
    0b01000100
.db 0b10000010,\
    0b10000010
.db 0b10000010,\
    0b01000100
.db 0b00111000,\
    0b00000000
// Character '
// ASCII Code(0XA)--------------------------------
.db 0b11000111,\
    0b10111011
.db 0b01111101,\
    0b01111101
.db 0b01111101,\
    0b10111011
.db 0b11000111,\
    0b11111111
// Character 'VT' ASCII Code(0XB)--------------------------------
.db 0b00001111,\
    0b00000011
.db 0b00000101,\
    0b01111001
.db 0b10001000,\
    0b10001000
.db 0b10001000,\
    0b01110000
// Character 'FF' ASCII Code(0XC)--------------------------------
.db 0b00111000,\
    0b01000100
.db 0b01000100,\
    0b01000100
.db 0b00111000,\
    0b00010000
.db 0b01111100,\
    0b00010000
// Character '
' ASCII Code(0XD)--------------------------------
.db 0b00110000,\
    0b00101000
.db 0b00100100,\
    0b00100100
.db 0b00101000,\
    0b00100000
.db 0b11100000,\
    0b11000000
// Character 'SO' ASCII Code(0XE)--------------------------------
.db 0b00111100,\
    0b00100100
.db 0b00111100,\
    0b00100100
.db 0b00100100,\
    0b11100100
.db 0b11011100,\
    0b00011000
// Character 'SI' ASCII Code(0XF)--------------------------------
.db 0b00010000,\
    0b01010100
.db 0b00111000,\
    0b11101110
.db 0b00111000,\
    0b01010100
.db 0b00010000,\
    0b00000000
// Character 'DLE' ASCII Code(0X10)--------------------------------
.db 0b00010000,\
    0b00010000
.db 0b00010000,\
    0b01111100
.db 0b00010000,\
    0b00010000
.db 0b00010000,\
    0b00010000
// Character 'DC1' ASCII Code(0X11)--------------------------------
.db 0b00010000,\
    0b00010000
.db 0b00010000,\
    0b11111111
.db 0b00000000,\
    0b00000000
.db 0b00000000,\
    0b00000000
// Character 'DC2' ASCII Code(0X12)--------------------------------
.db 0b00000000,\
    0b00000000
.db 0b00000000,\
    0b11111111
.db 0b00010000,\
    0b00010000
.db 0b00010000,\
    0b00010000
// Character 'DC3' ASCII Code(0X13)--------------------------------
.db 0b00010000,\
    0b00010000
.db 0b00010000,\
    0b11110000
.db 0b00010000,\
    0b00010000
.db 0b00010000,\
    0b00010000
// Character 'DC4' ASCII Code(0X14)--------------------------------
.db 0b00010000,\
    0b00010000
.db 0b00010000,\
    0b00011111
.db 0b00010000,\
    0b00010000
.db 0b00010000,\
    0b00010000
// Character 'NAK' ASCII Code(0X15)--------------------------------
.db 0b00010000,\
    0b00010000
.db 0b00010000,\
    0b11111111
.db 0b00010000,\
    0b00010000
.db 0b00010000,\
    0b00010000
// Character 'SYN' ASCII Code(0X16)--------------------------------
.db 0b00010000,\
    0b00010000
.db 0b00010000,\
    0b00010000
.db 0b00010000,\
    0b00010000
.db 0b00010000,\
    0b00010000
// Character 'ETB' ASCII Code(0X17)--------------------------------
.db 0b00000000,\
    0b00000000
.db 0b00000000,\
    0b11111111
.db 0b00000000,\
    0b00000000
.db 0b00000000,\
    0b00000000
// Character 'CAN' ASCII Code(0X18)--------------------------------
.db 0b00000000,\
    0b00000000
.db 0b00000000,\
    0b00011111
.db 0b00010000,\
    0b00010000
.db 0b00010000,\
    0b00010000
// Character 'EM' ASCII Code(0X19)--------------------------------
.db 0b00000000,\
    0b00000000
.db 0b00000000,\
    0b11110000
.db 0b00010000,\
    0b00010000
.db 0b00010000,\
    0b00010000
// Character 'SUB' ASCII Code(0X1A)--------------------------------
.db 0b00010000,\
    0b00010000
.db 0b00010000,\
    0b00011111
.db 0b00000000,\
    0b00000000
.db 0b00000000,\
    0b00000000
// Character 'ESC' ASCII Code(0X1B)--------------------------------
.db 0b00010000,\
    0b00010000
.db 0b00010000,\
    0b11110000
.db 0b00000000,\
    0b00000000
.db 0b00000000,\
    0b00000000
// Character 'FS' ASCII Code(0X1C)--------------------------------
.db 0b10000001,\
    0b01000010
.db 0b00100100,\
    0b00011000
.db 0b00011000,\
    0b00100100
.db 0b01000010,\
    0b10000001
// Character 'GS' ASCII Code(0X1D)--------------------------------
.db 0b00000001,\
    0b00000010
.db 0b00000100,\
    0b00001000
.db 0b00010000,\
    0b00100000
.db 0b01000000,\
    0b10000000
// Character 'RS' ASCII Code(0X1E)--------------------------------
.db 0b10000000,\
    0b01000000
.db 0b00100000,\
    0b00010000
.db 0b00001000,\
    0b00000100
.db 0b00000010,\
    0b00000001
// Character 'US' ASCII Code(0X1F)--------------------------------
.db 0b00000000,\
    0b00010000
.db 0b00010000,\
    0b11111111
.db 0b00010000,\
    0b00010000
.db 0b00000000,\
    0b00000000
#endif
// Character '' ASCII Code(0X20)--------------------------------
.db 0b00000000,\
    0b00000000
.db 0b00000000,\
    0b00000000
.db 0b00000000,\
    0b00000000
.db 0b00000000,\
    0b00000000
// Character '!' ASCII Code(0X21)--------------------------------
.db 0b00100000,\
    0b00100000
.db 0b00100000,\
    0b00100000
.db 0b00100000,\
    0b00000000
.db 0b00100000,\
    0b00000000
// Character '"' ASCII Code(0X22)--------------------------------
.db 0b01010000,\
    0b01010000
.db 0b01010000,\
    0b00000000
.db 0b00000000,\
    0b00000000
.db 0b00000000,\
    0b00000000
// Character '#' ASCII Code(0X23)--------------------------------
.db 0b01010000,\
    0b01010000
.db 0b11111000,\
    0b01010000
.db 0b11111000,\
    0b01010000
.db 0b01010000,\
    0b00000000
// Character '$' ASCII Code(0X24)--------------------------------
.db 0b00100000,\
    0b01111000
.db 0b10100000,\
    0b01110000
.db 0b00101000,\
    0b11110000
.db 0b00100000,\
    0b00000000
// Character '%' ASCII Code(0X25)--------------------------------
.db 0b11000000,\
    0b11001000
.db 0b00010000,\
    0b00100000
.db 0b01000000,\
    0b10011000
.db 0b00011000,\
    0b00000000
// Character '&' ASCII Code(0X26)--------------------------------
.db 0b01000000,\
    0b10100000
.db 0b01000000,\
    0b10101000
.db 0b10010000,\
    0b10011000
.db 0b01100000,\
    0b00000000
// Character ''' ASCII Code(0X27)--------------------------------
.db 0b00010000,\
    0b00100000
.db 0b01000000,\
    0b00000000
.db 0b00000000,\
    0b00000000
.db 0b00000000,\
    0b00000000
// Character '(' ASCII Code(0X28)--------------------------------
.db 0b00010000,\
    0b00100000
.db 0b01000000,\
    0b01000000
.db 0b01000000,\
    0b00100000
.db 0b00010000,\
    0b00000000
// Character ')' ASCII Code(0X29)--------------------------------
.db 0b01000000,\
    0b00100000
.db 0b00010000,\
    0b00010000
.db 0b00010000,\
    0b00100000
.db 0b01000000,\
    0b00000000
// Character '*' ASCII Code(0X2A)--------------------------------
.db 0b00100000,\
    0b10101000
.db 0b01110000,\
    0b00100000
.db 0b01110000,\
    0b10101000
.db 0b00100000,\
    0b00000000
// Character '+' ASCII Code(0X2B)--------------------------------
.db 0b00000000,\
    0b00100000
.db 0b00100000,\
    0b11111000
.db 0b00100000,\
    0b00100000
.db 0b00000000,\
    0b00000000
// Character ',' ASCII Code(0X2C)--------------------------------
.db 0b00000000,\
    0b00000000
.db 0b00000000,\
    0b00000000
.db 0b00000000,\
    0b00100000
.db 0b00100000,\
    0b01000000
// Character '-' ASCII Code(0X2D)--------------------------------
.db 0b00000000,\
    0b00000000
.db 0b00000000,\
    0b01111000
.db 0b00000000,\
    0b00000000
.db 0b00000000,\
    0b00000000
// Character '.' ASCII Code(0X2E)--------------------------------
.db 0b00000000,\
    0b00000000
.db 0b00000000,\
    0b00000000
.db 0b00000000,\
    0b01100000
.db 0b01100000,\
    0b00000000
// Character '/' ASCII Code(0X2F)--------------------------------
.db 0b00000000,\
    0b00000000
.db 0b00001000,\
    0b00010000
.db 0b00100000,\
    0b01000000
.db 0b10000000,\
    0b00000000
// Character '0' ASCII Code(0X30)--------------------------------
.db 0b01110000,\
    0b10001000
.db 0b10001000,\
    0b10001000
.db 0b10001000,\
    0b10001000
.db 0b01110000,\
    0b00000000
// Character '1' ASCII Code(0X31)--------------------------------
.db 0b00100000,\
    0b01100000
.db 0b10100000,\
    0b00100000
.db 0b00100000,\
    0b00100000
.db 0b11111000,\
    0b00000000
// Character '2' ASCII Code(0X32)--------------------------------
.db 0b01110000,\
    0b10001000
.db 0b00001000,\
    0b00010000
.db 0b01100000,\
    0b10000000
.db 0b11111000,\
    0b00000000
// Character '3' ASCII Code(0X33)--------------------------------
.db 0b01110000,\
    0b10001000
.db 0b00001000,\
    0b00110000
.db 0b00001000,\
    0b10001000
.db 0b01110000,\
    0b00000000
// Character '4' ASCII Code(0X34)--------------------------------
.db 0b00010000,\
    0b00110000
.db 0b01010000,\
    0b10010000
.db 0b11111000,\
    0b00010000
.db 0b00010000,\
    0b00000000
// Character '5' ASCII Code(0X35)--------------------------------
.db 0b11111000,\
    0b10000000
.db 0b11100000,\
    0b00010000
.db 0b00001000,\
    0b00010000
.db 0b11100000,\
    0b00000000
// Character '6' ASCII Code(0X36)--------------------------------
.db 0b00110000,\
    0b01000000
.db 0b10000000,\
    0b11110000
.db 0b10001000,\
    0b10001000
.db 0b01110000,\
    0b00000000
// Character '7' ASCII Code(0X37)--------------------------------
.db 0b11111000,\
    0b10001000
.db 0b00010000,\
    0b00100000
.db 0b00100000,\
    0b00100000
.db 0b00100000,\
    0b00000000
// Character '8' ASCII Code(0X38)--------------------------------
.db 0b01110000,\
    0b10001000
.db 0b10001000,\
    0b01110000
.db 0b10001000,\
    0b10001000
.db 0b01110000,\
    0b00000000
// Character '9' ASCII Code(0X39)--------------------------------
.db 0b01110000,\
    0b10001000
.db 0b10001000,\
    0b01111000
.db 0b00001000,\
    0b00010000
.db 0b01100000,\
    0b00000000
// Character ':' ASCII Code(0X3A)--------------------------------
.db 0b00000000,\
    0b00000000
.db 0b00100000,\
    0b00000000
.db 0b00000000,\
    0b00100000
.db 0b00000000,\
    0b00000000
// Character ';' ASCII Code(0X3B)--------------------------------
.db 0b00000000,\
    0b00000000
.db 0b00100000,\
    0b00000000
.db 0b00000000,\
    0b00100000
.db 0b00100000,\
    0b01000000
// Character '<' ASCII Code(0X3C)--------------------------------
.db 0b00011000,\
    0b00110000
.db 0b01100000,\
    0b11000000
.db 0b01100000,\
    0b00110000
.db 0b00011000,\
    0b00000000
// Character '=' ASCII Code(0X3D)--------------------------------
.db 0b00000000,\
    0b00000000
.db 0b11111000,\
    0b00000000
.db 0b11111000,\
    0b00000000
.db 0b00000000,\
    0b00000000
// Character '>' ASCII Code(0X3E)--------------------------------
.db 0b11000000,\
    0b01100000
.db 0b00110000,\
    0b00011000
.db 0b00110000,\
    0b01100000
.db 0b11000000,\
    0b00000000
// Character '?' ASCII Code(0X3F)--------------------------------
.db 0b01110000,\
    0b10001000
.db 0b00001000,\
    0b00010000
.db 0b00100000,\
    0b00000000
.db 0b00100000,\
    0b00000000
// Character '@' ASCII Code(0X40)--------------------------------
.db 0b01110000,\
    0b10001000
.db 0b00001000,\
    0b01001000
.db 0b10101000,\
    0b10101000
.db 0b01110000,\
    0b00000000
// Character 'A' ASCII Code(0X41)--------------------------------
.db 0b00100000,\
    0b01010000
.db 0b10001000,\
    0b10001000
.db 0b11111000,\
    0b10001000
.db 0b10001000,\
    0b00000000
// Character 'B' ASCII Code(0X42)--------------------------------
.db 0b11110000,\
    0b01001000
.db 0b01001000,\
    0b01110000
.db 0b01001000,\
    0b01001000
.db 0b11110000,\
    0b00000000
// Character 'C' ASCII Code(0X43)--------------------------------
.db 0b00110000,\
    0b01001000
.db 0b10000000,\
    0b10000000
.db 0b10000000,\
    0b01001000
.db 0b00110000,\
    0b00000000
// Character 'D' ASCII Code(0X44)--------------------------------
.db 0b11100000,\
    0b01010000
.db 0b01001000,\
    0b01001000
.db 0b01001000,\
    0b01010000
.db 0b11100000,\
    0b00000000
// Character 'E' ASCII Code(0X45)--------------------------------
.db 0b11111000,\
    0b10000000
.db 0b10000000,\
    0b11110000
.db 0b10000000,\
    0b10000000
.db 0b11111000,\
    0b00000000
// Character 'F' ASCII Code(0X46)--------------------------------
.db 0b11111000,\
    0b10000000
.db 0b10000000,\
    0b11110000
.db 0b10000000,\
    0b10000000
.db 0b10000000,\
    0b00000000
// Character 'G' ASCII Code(0X47)--------------------------------
.db 0b01110000,\
    0b10001000
.db 0b10000000,\
    0b10111000
.db 0b10001000,\
    0b10001000
.db 0b01110000,\
    0b00000000
// Character 'H' ASCII Code(0X48)--------------------------------
.db 0b10001000,\
    0b10001000
.db 0b10001000,\
    0b11111000
.db 0b10001000,\
    0b10001000
.db 0b10001000,\
    0b00000000
// Character 'I' ASCII Code(0X49)--------------------------------
.db 0b01110000,\
    0b00100000
.db 0b00100000,\
    0b00100000
.db 0b00100000,\
    0b00100000
.db 0b01110000,\
    0b00000000
// Character 'J' ASCII Code(0X4A)--------------------------------
.db 0b00111000,\
    0b00010000
.db 0b00010000,\
    0b00010000
.db 0b10010000,\
    0b10010000
.db 0b01100000,\
    0b00000000
// Character 'K' ASCII Code(0X4B)--------------------------------
.db 0b10001000,\
    0b10010000
.db 0b10100000,\
    0b11000000
.db 0b10100000,\
    0b10010000
.db 0b10001000,\
    0b00000000
// Character 'L' ASCII Code(0X4C)--------------------------------
.db 0b10000000,\
    0b10000000
.db 0b10000000,\
    0b10000000
.db 0b10000000,\
    0b10000000
.db 0b11111000,\
    0b00000000
// Character 'M' ASCII Code(0X4D)--------------------------------
.db 0b10001000,\
    0b11011000
.db 0b10101000,\
    0b10101000
.db 0b10001000,\
    0b10001000
.db 0b10001000,\
    0b00000000
// Character 'N' ASCII Code(0X4E)--------------------------------
.db 0b10001000,\
    0b11001000
.db 0b11001000,\
    0b10101000
.db 0b10011000,\
    0b10011000
.db 0b10001000,\
    0b00000000
// Character 'O' ASCII Code(0X4F)--------------------------------
.db 0b01110000,\
    0b10001000
.db 0b10001000,\
    0b10001000
.db 0b10001000,\
    0b10001000
.db 0b01110000,\
    0b00000000
// Character 'P' ASCII Code(0X50)--------------------------------
.db 0b11110000,\
    0b10001000
.db 0b10001000,\
    0b11110000
.db 0b10000000,\
    0b10000000
.db 0b10000000,\
    0b00000000
// Character 'Q' ASCII Code(0X51)--------------------------------
.db 0b01110000,\
    0b10001000
.db 0b10001000,\
    0b10001000
.db 0b10101000,\
    0b10010000
.db 0b01101000,\
    0b00000000
// Character 'R' ASCII Code(0X52)--------------------------------
.db 0b11110000,\
    0b10001000
.db 0b10001000,\
    0b11110000
.db 0b10100000,\
    0b10010000
.db 0b10001000,\
    0b00000000
// Character 'S' ASCII Code(0X53)--------------------------------
.db 0b01110000,\
    0b10001000
.db 0b10000000,\
    0b01110000
.db 0b00001000,\
    0b10001000
.db 0b01110000,\
    0b00000000
// Character 'T' ASCII Code(0X54)--------------------------------
.db 0b11111000,\
    0b00100000
.db 0b00100000,\
    0b00100000
.db 0b00100000,\
    0b00100000
.db 0b00100000,\
    0b00000000
// Character 'U' ASCII Code(0X55)--------------------------------
.db 0b10001000,\
    0b10001000
.db 0b10001000,\
    0b10001000
.db 0b10001000,\
    0b10001000
.db 0b01110000,\
    0b00000000
// Character 'V' ASCII Code(0X56)--------------------------------
.db 0b10001000,\
    0b10001000
.db 0b10001000,\
    0b10001000
.db 0b01010000,\
    0b01010000
.db 0b00100000,\
    0b00000000
// Character 'W' ASCII Code(0X57)--------------------------------
.db 0b10001000,\
    0b10001000
.db 0b10001000,\
    0b10101000
.db 0b10101000,\
    0b11011000
.db 0b10001000,\
    0b00000000
// Character 'X' ASCII Code(0X58)--------------------------------
.db 0b10001000,\
    0b10001000
.db 0b01010000,\
    0b00100000
.db 0b01010000,\
    0b10001000
.db 0b10001000,\
    0b00000000
// Character 'Y' ASCII Code(0X59)--------------------------------
.db 0b10001000,\
    0b10001000
.db 0b10001000,\
    0b01110000
.db 0b00100000,\
    0b00100000
.db 0b00100000,\
    0b00000000
// Character 'Z' ASCII Code(0X5A)--------------------------------
.db 0b11111000,\
    0b00001000
.db 0b00010000,\
    0b00100000
.db 0b01000000,\
    0b10000000
.db 0b11111000,\
    0b00000000
// Character '[' ASCII Code(0X5B)--------------------------------
.db 0b01110000,\
    0b01000000
.db 0b01000000,\
    0b01000000
.db 0b01000000,\
    0b01000000
.db 0b01110000,\
    0b00000000
// Character '\' ASCII Code(0X5C)--------------------------------
.db 0b00000000,\
    0b00000000
.db 0b10000000,\
    0b01000000
.db 0b00100000,\
    0b00010000
.db 0b00001000,\
    0b00000000
// Character ']' ASCII Code(0X5D)--------------------------------
.db 0b01110000,\
    0b00010000
.db 0b00010000,\
    0b00010000
.db 0b00010000,\
    0b00010000
.db 0b01110000,\
    0b00000000
// Character '^' ASCII Code(0X5E)--------------------------------
.db 0b00100000,\
    0b01010000
.db 0b10001000,\
    0b00000000
.db 0b00000000,\
    0b00000000
.db 0b00000000,\
    0b00000000
// Character '_' ASCII Code(0X5F)--------------------------------
.db 0b00000000,\
    0b00000000
.db 0b00000000,\
    0b00000000
.db 0b00000000,\
    0b00000000
.db 0b11111000,\
    0b00000000
// Character '`' ASCII Code(0X60)--------------------------------
.db 0b10000000,\
    0b01000000
.db 0b00100000,\
    0b00000000
.db 0b00000000,\
    0b00000000
.db 0b00000000,\
    0b00000000
// Character 'a' ASCII Code(0X61)--------------------------------
.db 0b00000000,\
    0b00000000
.db 0b01110000,\
    0b00001000
.db 0b01111000,\
    0b10001000
.db 0b01111000,\
    0b00000000
// Character 'b' ASCII Code(0X62)--------------------------------
.db 0b10000000,\
    0b10000000
.db 0b10110000,\
    0b11001000
.db 0b10001000,\
    0b11001000
.db 0b10110000,\
    0b00000000
// Character 'c' ASCII Code(0X63)--------------------------------
.db 0b00000000,\
    0b00000000
.db 0b01110000,\
    0b10001000
.db 0b10000000,\
    0b10001000
.db 0b01110000,\
    0b00000000
// Character 'd' ASCII Code(0X64)--------------------------------
.db 0b00001000,\
    0b00001000
.db 0b01101000,\
    0b10011000
.db 0b10001000,\
    0b10011000
.db 0b01101000,\
    0b00000000
// Character 'e' ASCII Code(0X65)--------------------------------
.db 0b00000000,\
    0b00000000
.db 0b01110000,\
    0b10001000
.db 0b11111000,\
    0b10000000
.db 0b01110000,\
    0b00000000
// Character 'f' ASCII Code(0X66)--------------------------------
.db 0b00010000,\
    0b00101000
.db 0b00100000,\
    0b11111000
.db 0b00100000,\
    0b00100000
.db 0b00100000,\
    0b00000000
// Character 'g' ASCII Code(0X67)--------------------------------
.db 0b00000000,\
    0b00000000
.db 0b01101000,\
    0b10011000
.db 0b10011000,\
    0b01101000
.db 0b00001000,\
    0b01110000
// Character 'h' ASCII Code(0X68)--------------------------------
.db 0b10000000,\
    0b10000000
.db 0b11110000,\
    0b10001000
.db 0b10001000,\
    0b10001000
.db 0b10001000,\
    0b00000000
// Character 'i' ASCII Code(0X69)--------------------------------
.db 0b00100000,\
    0b00000000
.db 0b01100000,\
    0b00100000
.db 0b00100000,\
    0b00100000
.db 0b01110000,\
    0b00000000
// Character 'j' ASCII Code(0X6A)--------------------------------
.db 0b00010000,\
    0b00000000
.db 0b00110000,\
    0b00010000
.db 0b00010000,\
    0b00010000
.db 0b10010000,\
    0b01100000
// Character 'k' ASCII Code(0X6B)--------------------------------
.db 0b01000000,\
    0b01000000
.db 0b01001000,\
    0b01010000
.db 0b01100000,\
    0b01010000
.db 0b01001000,\
    0b00000000
// Character 'l' ASCII Code(0X6C)--------------------------------
.db 0b01100000,\
    0b00100000
.db 0b00100000,\
    0b00100000
.db 0b00100000,\
    0b00100000
.db 0b01110000,\
    0b00000000
// Character 'm' ASCII Code(0X6D)--------------------------------
.db 0b00000000,\
    0b00000000
.db 0b11010000,\
    0b10101000
.db 0b10101000,\
    0b10101000
.db 0b10101000,\
    0b00000000
// Character 'n' ASCII Code(0X6E)--------------------------------
.db 0b00000000,\
    0b00000000
.db 0b10110000,\
    0b11001000
.db 0b10001000,\
    0b10001000
.db 0b10001000,\
    0b00000000
// Character 'o' ASCII Code(0X6F)--------------------------------
.db 0b00000000,\
    0b00000000
.db 0b01110000,\
    0b10001000
.db 0b10001000,\
    0b10001000
.db 0b01110000,\
    0b00000000
// Character 'p' ASCII Code(0X70)--------------------------------
.db 0b00000000,\
    0b00000000
.db 0b10110000,\
    0b11001000
.db 0b11001000,\
    0b10110000
.db 0b10000000,\
    0b10000000
// Character 'q' ASCII Code(0X71)--------------------------------
.db 0b00000000,\
    0b00000000
.db 0b01101000,\
    0b10011000
.db 0b10011000,\
    0b01101000
.db 0b00001000,\
    0b00001000
// Character 'r' ASCII Code(0X72)--------------------------------
.db 0b00000000,\
    0b00000000
.db 0b10110000,\
    0b11001000
.db 0b10000000,\
    0b10000000
.db 0b10000000,\
    0b00000000
// Character 's' ASCII Code(0X73)--------------------------------
.db 0b00000000,\
    0b00000000
.db 0b01111000,\
    0b10000000
.db 0b01110000,\
    0b00001000
.db 0b11110000,\
    0b00000000
// Character 't' ASCII Code(0X74)--------------------------------
.db 0b01000000,\
    0b01000000
.db 0b11110000,\
    0b01000000
.db 0b01000000,\
    0b01001000
.db 0b00110000,\
    0b00000000
// Character 'u' ASCII Code(0X75)--------------------------------
.db 0b00000000,\
    0b00000000
.db 0b10010000,\
    0b10010000
.db 0b10010000,\
    0b10010000
.db 0b01101000,\
    0b00000000
// Character 'v' ASCII Code(0X76)--------------------------------
.db 0b00000000,\
    0b00000000
.db 0b10001000,\
    0b10001000
.db 0b10001000,\
    0b01010000
.db 0b00100000,\
    0b00000000
// Character 'w' ASCII Code(0X77)--------------------------------
.db 0b00000000,\
    0b00000000
.db 0b10001000,\
    0b10101000
.db 0b10101000,\
    0b10101000
.db 0b01010000,\
    0b00000000
// Character 'x' ASCII Code(0X78)--------------------------------
.db 0b00000000,\
    0b00000000
.db 0b10001000,\
    0b01010000
.db 0b00100000,\
    0b01010000
.db 0b10001000,\
    0b00000000
// Character 'y' ASCII Code(0X79)--------------------------------
.db 0b00000000,\
    0b00000000
.db 0b10001000,\
    0b10001000
.db 0b10011000,\
    0b01101000
.db 0b00001000,\
    0b01110000
// Character 'z' ASCII Code(0X7A)--------------------------------
.db 0b00000000,\
    0b00000000
.db 0b11111000,\
    0b00010000
.db 0b00100000,\
    0b01000000
.db 0b11111000,\
    0b00000000
// Character '{' ASCII Code(0X7B)--------------------------------
;.db 0b00011000,\
;    0b00100000
;.db 0b00100000,\
;    0b01000000
;.db 0b00100000,\
;    0b00100000
;.db 0b00011000,\
;    0b00000000
// Character '{' ASCII Code(0X7B)--------------------------------
.db 0b00000001,\
    0b00000010
.db 0b00000100,\
    0b00001000
.db 0b01001000,\
    0b00110000
.db 0b00010000,\
    0b00000000

// Character '|' ASCII Code(0X7C)--------------------------------
.db 0b00100000,\
    0b00100000
.db 0b00100000,\
    0b00000000
.db 0b00100000,\
    0b00100000
.db 0b00100000,\
    0b00000000
// Character '}' ASCII Code(0X7D)--------------------------------
;.db 0b11000000,\
;    0b00100000
;.db 0b00100000,\
;    0b00010000
;.db 0b00100000,\
;    0b00100000
;.db 0b11000000,\
;    0b00000000

// Character '}' ASCII Code(0X7D)--------------------------------
.db 0b00000000,\
    0b00000000
.db 0b00000000,\
    0b01111111
.db 0b00111110,\
    0b00011100
.db 0b00001000,\
    0b00000000

// Character '~' ASCII Code(0X7E)--------------------------------
;.db 0b01000000,\
;    0b10101000
;.db 0b00010000,\
;    0b00000000
;.db 0b00000000,\
;    0b00000000
;.db 0b00000000,\
 ;   0b00000000

	// Character '~' ASCII Code(0X7E)--------------------------------
.db 0b10001000,\
    0b01011000
.db 0b00101000,\
    0b11001000
.db 0b11001100,\
    0b00101010
.db 0b00011001,\
    0b00001000

/*
//
//if not defiend ascii font insert all characters 
//
#ifndef __ASCII_FONT__
// Character '' ASCII Code(0X7F)--------------------------------
.db 0b00000000,\
    0b00000000
.db 0b00100000,\
    0b01010000
.db 0b11111000,\
    0b00000000
.db 0b00000000,\
    0b00000000
// Character '€' ASCII Code(0X80)--------------------------------
.db 0b00110000,\
    0b01001000
.db 0b10000000,\
    0b10000000
.db 0b10000000,\
    0b01001000
.db 0b00110000,\
    0b01100000
// Character '�' ASCII Code(0X81)--------------------------------
.db 0b10010000,\
    0b00000000
.db 0b10010000,\
    0b10010000
.db 0b10010000,\
    0b10010000
.db 0b01101000,\
    0b00000000
// Character '‚' ASCII Code(0X82)--------------------------------
.db 0b00010000,\
    0b00100000
.db 0b01110000,\
    0b10001000
.db 0b11111000,\
    0b10000000
.db 0b01110000,\
    0b00000000
// Character 'ƒ' ASCII Code(0X83)--------------------------------
.db 0b00100000,\
    0b01010000
.db 0b01110000,\
    0b00001000
.db 0b01111000,\
    0b10001000
.db 0b01111000,\
    0b00000000
// Character '„' ASCII Code(0X84)--------------------------------
.db 0b00010000,\
    0b00100000
.db 0b00100000,\
    0b01010000
.db 0b10001000,\
    0b11111000
.db 0b10001000,\
    0b00000000
// Character '…' ASCII Code(0X85)--------------------------------
.db 0b01000000,\
    0b00100000
.db 0b01110000,\
    0b00001000
.db 0b01111000,\
    0b10001000
.db 0b01111000,\
    0b00000000
// Character '†' ASCII Code(0X86)--------------------------------
.db 0b01010000,\
    0b00000000
.db 0b00000000,\
    0b00000000
.db 0b00000000,\
    0b00000000
.db 0b00000000,\
    0b00000000
// Character '‡' ASCII Code(0X87)--------------------------------
.db 0b00000000,\
    0b00000000
.db 0b01110000,\
    0b10001000
.db 0b10000000,\
    0b10001000
.db 0b01110000,\
    0b00100000
// Character 'ˆ' ASCII Code(0X88)--------------------------------
.db 0b00100000,\
    0b01010000
.db 0b01110000,\
    0b10001000
.db 0b11111000,\
    0b10000000
.db 0b01110000,\
    0b00000000
// Character '‰' ASCII Code(0X89)--------------------------------
.db 0b00010000,\
    0b00100000
.db 0b01110000,\
    0b00100000
.db 0b00100000,\
    0b00100000
.db 0b01110000,\
    0b00000000
// Character 'Š' ASCII Code(0X8A)--------------------------------
.db 0b00010000,\
    0b00100000
.db 0b01110000,\
    0b10001000
.db 0b10001000,\
    0b10001000
.db 0b01110000,\
    0b00000000
// Character '‹' ASCII Code(0X8B)--------------------------------
.db 0b00010000,\
    0b00100000
.db 0b10001000,\
    0b10001000
.db 0b10001000,\
    0b10001000
.db 0b01110000,\
    0b00000000
// Character 'Œ' ASCII Code(0X8C)--------------------------------
.db 0b00100000,\
    0b01010000
.db 0b00100000,\
    0b01010000
.db 0b10001000,\
    0b11111000
.db 0b10001000,\
    0b00000000
// Character '�' ASCII Code(0X8D)--------------------------------
.db 0b00100000,\
    0b01010000
.db 0b11111000,\
    0b10000000
.db 0b11110000,\
    0b10000000
.db 0b11111000,\
    0b00000000
// Character 'Ž' ASCII Code(0X8E)--------------------------------
.db 0b00100000,\
    0b01010000
.db 0b01110000,\
    0b10001000
.db 0b10001000,\
    0b10001000
.db 0b01110000,\
    0b00000000
// Character '�' ASCII Code(0X8F)--------------------------------
.db 0b01000000,\
    0b00100000
.db 0b00100000,\
    0b01010000
.db 0b10001000,\
    0b11111000
.db 0b10001000,\
    0b00000000
// Character '�' ASCII Code(0X90)--------------------------------
.db 0b00010000,\
    0b00100000
.db 0b11111000,\
    0b10000000
.db 0b11110000,\
    0b10000000
.db 0b11111000,\
    0b00000000
// Character '‘' ASCII Code(0X91)--------------------------------
.db 0b00000000,\
    0b00000000
.db 0b01101100,\
    0b00010010
.db 0b01111110,\
    0b10010000
.db 0b01101110,\
    0b00000000
// Character '’' ASCII Code(0X92)--------------------------------
.db 0b00111110,\
    0b01010000
.db 0b10010000,\
    0b10011100
.db 0b11110000,\
    0b10010000
.db 0b10011110,\
    0b00000000
// Character '“' ASCII Code(0X93)--------------------------------
.db 0b00100000,\
    0b01010000
.db 0b01110000,\
    0b10001000
.db 0b10001000,\
    0b10001000
.db 0b01110000,\
    0b00000000
// Character '”' ASCII Code(0X94)--------------------------------
.db 0b01010000,\
    0b00000000
.db 0b01110000,\
    0b10001000
.db 0b10001000,\
    0b10001000
.db 0b01110000,\
    0b00000000
// Character '•' ASCII Code(0X95)--------------------------------
.db 0b01000000,\
    0b00100000
.db 0b01110000,\
    0b10001000
.db 0b10001000,\
    0b10001000
.db 0b01110000,\
    0b00000000
// Character '–' ASCII Code(0X96)--------------------------------
.db 0b00100000,\
    0b01010000
.db 0b00000000,\
    0b10010000
.db 0b10010000,\
    0b10010000
.db 0b01101000,\
    0b00000000
// Character '—' ASCII Code(0X97)--------------------------------
.db 0b01000000,\
    0b00100000
.db 0b00000000,\
    0b10010000
.db 0b10010000,\
    0b10010000
.db 0b01101000,\
    0b00000000
// Character '˜' ASCII Code(0X98)--------------------------------
.db 0b01010000,\
    0b00000000
.db 0b10001000,\
    0b10001000
.db 0b10011000,\
    0b01101000
.db 0b00001000,\
    0b01110000
// Character '™' ASCII Code(0X99)--------------------------------
.db 0b01010000,\
    0b00000000
.db 0b01110000,\
    0b10001000
.db 0b10001000,\
    0b10001000
.db 0b01110000,\
    0b00000000
// Character 'š' ASCII Code(0X9A)--------------------------------
.db 0b10001000,\
    0b00000000
.db 0b10001000,\
    0b10001000
.db 0b10001000,\
    0b10001000
.db 0b01110000,\
    0b00000000
// Character '›' ASCII Code(0X9B)--------------------------------
.db 0b00100000,\
    0b00100000
.db 0b01111000,\
    0b10000000
.db 0b10000000,\
    0b01111000
.db 0b00100000,\
    0b00100000
// Character 'œ' ASCII Code(0X9C)--------------------------------
.db 0b00011000,\
    0b00100100
.db 0b00100000,\
    0b11111000
.db 0b00100000,\
    0b11100010
.db 0b01011100,\
    0b00000000
// Character '�' ASCII Code(0X9D)--------------------------------
.db 0b10001000,\
    0b01010000
.db 0b00100000,\
    0b11111000
.db 0b00100000,\
    0b11111000
.db 0b00100000,\
    0b00000000
// Character 'ž' ASCII Code(0X9E)--------------------------------
.db 0b01100000,\
    0b10000000
.db 0b10011100,\
    0b10000100
.db 0b10001000,\
    0b10010000
.db 0b01111100,\
    0b00000000
// Character 'Ÿ' ASCII Code(0X9F)--------------------------------
.db 0b00011000,\
    0b00100000
.db 0b00100000,\
    0b11111000
.db 0b00100000,\
    0b00100000
.db 0b00100000,\
    0b01000000
// Character ' ' ASCII Code(0XA0)--------------------------------
.db 0b00010000,\
    0b00100000
.db 0b01110000,\
    0b00001000
.db 0b01111000,\
    0b10001000
.db 0b01111000,\
    0b00000000
// Character '¡' ASCII Code(0XA1)--------------------------------
.db 0b00010000,\
    0b00100000
.db 0b00000000,\
    0b01100000
.db 0b00100000,\
    0b00100000
.db 0b01110000,\
    0b00000000
// Character '¢' ASCII Code(0XA2)--------------------------------
.db 0b00010000,\
    0b00100000
.db 0b01110000,\
    0b10001000
.db 0b10001000,\
    0b10001000
.db 0b01110000,\
    0b00000000
// Character '£' ASCII Code(0XA3)--------------------------------
.db 0b00010000,\
    0b00100000
.db 0b10010000,\
    0b10010000
.db 0b10010000,\
    0b10010000
.db 0b01101000,\
    0b00000000
// Character '¤' ASCII Code(0XA4)--------------------------------
.db 0b00101000,\
    0b01010000
.db 0b10110000,\
    0b11001000
.db 0b10001000,\
    0b10001000
.db 0b10001000,\
    0b00000000
// Character '¥' ASCII Code(0XA5)--------------------------------
.db 0b00101000,\
    0b01010000
.db 0b10001000,\
    0b11001000
.db 0b10101000,\
    0b10011000
.db 0b10001000,\
    0b00000000
// Character '¦' ASCII Code(0XA6)--------------------------------
.db 0b01100000,\
    0b10010000
.db 0b10010000,\
    0b01101000
.db 0b00000000,\
    0b11111000
.db 0b00000000,\
    0b00000000
// Character '§' ASCII Code(0XA7)--------------------------------
.db 0b01100000,\
    0b10010000
.db 0b10010000,\
    0b01100000
.db 0b00000000,\
    0b11110000
.db 0b00000000,\
    0b00000000
// Character '¨' ASCII Code(0XA8)--------------------------------
.db 0b00100000,\
    0b00000000
.db 0b00100000,\
    0b01000000
.db 0b10000000,\
    0b10001000
.db 0b01110000,\
    0b00000000
// Character '©' ASCII Code(0XA9)--------------------------------
.db 0b00000000,\
    0b00000000
.db 0b00000000,\
    0b11111000
.db 0b10000000,\
    0b10000000
.db 0b00000000,\
    0b00000000
// Character 'ª' ASCII Code(0XAA)--------------------------------
.db 0b00000000,\
    0b00000000
.db 0b00000000,\
    0b11111000
.db 0b00001000,\
    0b00001000
.db 0b00000000,\
    0b00000000
// Character '«' ASCII Code(0XAB)--------------------------------
.db 0b10000100,\
    0b10001000
.db 0b10010000,\
    0b10101000
.db 0b01010100,\
    0b10000100
.db 0b00001000,\
    0b00011100
// Character '¬' ASCII Code(0XAC)--------------------------------
.db 0b10000100,\
    0b10001000
.db 0b10010000,\
    0b10101000
.db 0b01011000,\
    0b10101000
.db 0b00111100,\
    0b00001000
// Character '­' ASCII Code(0XAD)--------------------------------
.db 0b00100000,\
    0b00000000
.db 0b00000000,\
    0b00100000
.db 0b00100000,\
    0b00100000
.db 0b00100000,\
    0b00000000
// Character '®' ASCII Code(0XAE)--------------------------------
.db 0b00000000,\
    0b00010010
.db 0b00100100,\
    0b01001000
.db 0b10010000,\
    0b01001000
.db 0b00100100,\
    0b00010010
// Character '¯' ASCII Code(0XAF)--------------------------------
.db 0b00000000,\
    0b10010000
.db 0b01001000,\
    0b00100100
.db 0b00010010,\
    0b00100100
.db 0b01001000,\
    0b10010000
// Character '°' ASCII Code(0XB0)--------------------------------
.db 0b00101000,\
    0b01010000
.db 0b00100000,\
    0b01010000
.db 0b10001000,\
    0b11111000
.db 0b10001000,\
    0b00000000
// Character '±' ASCII Code(0XB1)--------------------------------
.db 0b00101000,\
    0b01010000
.db 0b01110000,\
    0b00001000
.db 0b01111000,\
    0b10001000
.db 0b01111000,\
    0b00000000
// Character '²' ASCII Code(0XB2)--------------------------------
.db 0b00101000,\
    0b01010000
.db 0b00000000,\
    0b01110000
.db 0b00100000,\
    0b00100000
.db 0b01110000,\
    0b00000000
// Character '³' ASCII Code(0XB3)--------------------------------
.db 0b00101000,\
    0b01010000
.db 0b00000000,\
    0b00100000
.db 0b00100000,\
    0b00100000
.db 0b01110000,\
    0b00000000
// Character '´' ASCII Code(0XB4)--------------------------------
.db 0b00101000,\
    0b01010000
.db 0b01110000,\
    0b10001000
.db 0b10001000,\
    0b10001000
.db 0b01110000,\
    0b00000000
// Character 'µ' ASCII Code(0XB5)--------------------------------
.db 0b00101000,\
    0b01010000
.db 0b01110000,\
    0b10001000
.db 0b10001000,\
    0b10001000
.db 0b01110000,\
    0b00000000
// Character '¶' ASCII Code(0XB6)--------------------------------
.db 0b00101000,\
    0b01010000
.db 0b00000000,\
    0b10001000
.db 0b10001000,\
    0b10001000
.db 0b01110000,\
    0b00000000
// Character '·' ASCII Code(0XB7)--------------------------------
.db 0b00101000,\
    0b01010000
.db 0b00000000,\
    0b10010000
.db 0b10010000,\
    0b10010000
.db 0b01101000,\
    0b00000000
// Character '¸' ASCII Code(0XB8)--------------------------------
.db 0b11111100,\
    0b01001000
.db 0b01001000,\
    0b01001000
.db 0b11101000,\
    0b00001000
.db 0b01010000,\
    0b00100000
// Character '¹' ASCII Code(0XB9)--------------------------------
.db 0b00000000,\
    0b10100000
.db 0b00000000,\
    0b10100000
.db 0b10100000,\
    0b10100000
.db 0b00100000,\
    0b01000000
// Character 'º' ASCII Code(0XBA)--------------------------------
.db 0b11000000,\
    0b01000100
.db 0b11001000,\
    0b01010100
.db 0b11101100,\
    0b01010100
.db 0b10011110,\
    0b00000100
// Character '»' ASCII Code(0XBB)--------------------------------
.db 0b00010000,\
    0b10101000
.db 0b01000000,\
    0b00000000
.db 0b00000000,\
    0b00000000
.db 0b00000000,\
    0b00000000
// Character '¼' ASCII Code(0XBC)--------------------------------
.db 0b00000000,\
    0b00100000
.db 0b01010000,\
    0b10001000
.db 0b01010000,\
    0b00100000
.db 0b00000000,\
    0b00000000
// Character '½' ASCII Code(0XBD)--------------------------------
.db 0b11000100,\
    0b11001000
.db 0b00010000,\
    0b00100000
.db 0b01000000,\
    0b10110110
.db 0b00110110,\
    0b00000000
// Character '¾' ASCII Code(0XBE)--------------------------------
.db 0b01111100,\
    0b10101000
.db 0b10101000,\
    0b01101000
.db 0b00101000,\
    0b00101000
.db 0b00101000,\
    0b00000000
// Character '¿' ASCII Code(0XBF)--------------------------------
.db 0b00111000,\
    0b01000000
.db 0b00110000,\
    0b01001000
.db 0b01001000,\
    0b00110000
.db 0b00001000,\
    0b01110000
// Character 'À' ASCII Code(0XC0)--------------------------------
.db 0b00000000,\
    0b00000000
.db 0b00000000,\
    0b00000000
.db 0b00000000,\
    0b00000000
.db 0b11111111,\
    0b11111111
// Character 'Á' ASCII Code(0XC1)--------------------------------
.db 0b11110000,\
    0b11110000
.db 0b11110000,\
    0b11110000
.db 0b00001111,\
    0b00001111
.db 0b00001111,\
    0b00001111
// Character 'Â' ASCII Code(0XC2)--------------------------------
.db 0b00000000,\
    0b00000000
.db 0b11111111,\
    0b11111111
.db 0b11111111,\
    0b11111111
.db 0b11111111,\
    0b11111111
// Character 'Ã' ASCII Code(0XC3)--------------------------------
.db 0b11111111,\
    0b11111111
.db 0b00000000,\
    0b00000000
.db 0b00000000,\
    0b00000000
.db 0b00000000,\
    0b00000000
// Character 'Ä' ASCII Code(0XC4)--------------------------------
.db 0b00000000,\
    0b00000000
.db 0b00000000,\
    0b00111100
.db 0b00111100,\
    0b00000000
.db 0b00000000,\
    0b00000000
// Character 'Å' ASCII Code(0XC5)--------------------------------
.db 0b11111111,\
    0b11111111
.db 0b11111111,\
    0b11111111
.db 0b11111111,\
    0b11111111
.db 0b00000000,\
    0b00000000
// Character 'Æ' ASCII Code(0XC6)--------------------------------
.db 0b11000000,\
    0b11000000
.db 0b11000000,\
    0b11000000
.db 0b11000000,\
    0b11000000
.db 0b11000000,\
    0b11000000
// Character 'Ç' ASCII Code(0XC7)--------------------------------
.db 0b00001111,\
    0b00001111
.db 0b00001111,\
    0b00001111
.db 0b11110000,\
    0b11110000
.db 0b11110000,\
    0b11110000
// Character 'È' ASCII Code(0XC8)--------------------------------
.db 0b11111100,\
    0b11111100
.db 0b11111100,\
    0b11111100
.db 0b11111100,\
    0b11111100
.db 0b11111100,\
    0b11111100
// Character 'É' ASCII Code(0XC9)--------------------------------
.db 0b00000011,\
    0b00000011
.db 0b00000011,\
    0b00000011
.db 0b00000011,\
    0b00000011
.db 0b00000011,\
    0b00000011
// Character 'Ê' ASCII Code(0XCA)--------------------------------
.db 0b00111111,\
    0b00111111
.db 0b00111111,\
    0b00111111
.db 0b00111111,\
    0b00111111
.db 0b00111111,\
    0b00111111
// Character 'Ë' ASCII Code(0XCB)--------------------------------
.db 0b00010001,\
    0b00100010
.db 0b01000100,\
    0b10001000
.db 0b00010001,\
    0b00100010
.db 0b01000100,\
    0b10001000
// Character 'Ì' ASCII Code(0XCC)--------------------------------
.db 0b10001000,\
    0b01000100
.db 0b00100010,\
    0b00010001
.db 0b10001000,\
    0b01000100
.db 0b00100010,\
    0b00010001
// Character 'Í' ASCII Code(0XCD)--------------------------------
.db 0b11111110,\
    0b01111100
.db 0b00111000,\
    0b00010000
.db 0b00000000,\
    0b00000000
.db 0b00000000,\
    0b00000000
// Character 'Î' ASCII Code(0XCE)--------------------------------
.db 0b00000000,\
    0b00000000
.db 0b00000000,\
    0b00000000
.db 0b00010000,\
    0b00111000
.db 0b01111100,\
    0b11111110
// Character 'Ï' ASCII Code(0XCF)--------------------------------
.db 0b10000000,\
    0b11000000
.db 0b11100000,\
    0b11110000
.db 0b11100000,\
    0b11000000
.db 0b10000000,\
    0b00000000
// Character 'Ð' ASCII Code(0XD0)--------------------------------
.db 0b00000001,\
    0b00000011
.db 0b00000111,\
    0b00001111
.db 0b00000111,\
    0b00000011
.db 0b00000001,\
    0b00000000
// Character 'Ñ' ASCII Code(0XD1)--------------------------------
.db 0b11111111,\
    0b01111110
.db 0b00111100,\
    0b00011000
.db 0b00011000,\
    0b00111100
.db 0b01111110,\
    0b11111111
// Character 'Ò' ASCII Code(0XD2)--------------------------------
.db 0b10000001,\
    0b11000011
.db 0b11100111,\
    0b11111111
.db 0b11111111,\
    0b11100111
.db 0b11000011,\
    0b10000001
// Character 'Ó' ASCII Code(0XD3)--------------------------------
.db 0b11110000,\
    0b11110000
.db 0b11110000,\
    0b11110000
.db 0b00000000,\
    0b00000000
.db 0b00000000,\
    0b00000000
// Character 'Ô' ASCII Code(0XD4)--------------------------------
.db 0b00000000,\
    0b00000000
.db 0b00000000,\
    0b00000000
.db 0b00001111,\
    0b00001111
.db 0b00001111,\
    0b00001111
// Character 'Õ' ASCII Code(0XD5)--------------------------------
.db 0b00001111,\
    0b00001111
.db 0b00001111,\
    0b00001111
.db 0b00000000,\
    0b00000000
.db 0b00000000,\
    0b00000000
// Character 'Ö' ASCII Code(0XD6)--------------------------------
.db 0b00000000,\
    0b00000000
.db 0b00000000,\
    0b00000000
.db 0b11110000,\
    0b11110000
.db 0b11110000,\
    0b11110000
// Character '×' ASCII Code(0XD7)--------------------------------
.db 0b00110011,\
    0b00110011
.db 0b11001100,\
    0b11001100
.db 0b00110011,\
    0b00110011
.db 0b11001100,\
    0b11001100
// Character 'Ø' ASCII Code(0XD8)--------------------------------
.db 0b00000000,\
    0b00100000
.db 0b00100000,\
    0b01010000
.db 0b01010000,\
    0b10001000
.db 0b11111000,\
    0b00000000
// Character 'Ù' ASCII Code(0XD9)--------------------------------
.db 0b00100000,\
    0b00100000
.db 0b01110000,\
    0b00100000
.db 0b01110000,\
    0b00100000
.db 0b00100000,\
    0b00000000
// Character 'Ú' ASCII Code(0XDA)--------------------------------
.db 0b00000000,\
    0b00000000
.db 0b00000000,\
    0b01010000
.db 0b10001000,\
    0b10101000
.db 0b01010000,\
    0b00000000
// Character 'Û' ASCII Code(0XDB)--------------------------------
.db 0b11111111,\
    0b11111111
.db 0b11111111,\
    0b11111111
.db 0b11111111,\
    0b11111111
.db 0b11111111,\
    0b11111111
// Character 'Ü' ASCII Code(0XDC)--------------------------------
.db 0b00000000,\
    0b00000000
.db 0b00000000,\
    0b00000000
.db 0b11111111,\
    0b11111111
.db 0b11111111,\
    0b11111111
// Character 'Ý' ASCII Code(0XDD)--------------------------------
.db 0b11110000,\
    0b11110000
.db 0b11110000,\
    0b11110000
.db 0b11110000,\
    0b11110000
.db 0b11110000,\
    0b11110000
// Character 'Þ' ASCII Code(0XDE)--------------------------------
.db 0b00001111,\
    0b00001111
.db 0b00001111,\
    0b00001111
.db 0b00001111,\
    0b00001111
.db 0b00001111,\
    0b00001111
// Character 'ß' ASCII Code(0XDF)--------------------------------
.db 0b11111111,\
    0b11111111
.db 0b11111111,\
    0b11111111
.db 0b00000000,\
    0b00000000
.db 0b00000000,\
    0b00000000
// Character 'à' ASCII Code(0XE0)--------------------------------
.db 0b00000000,\
    0b00000000
.db 0b01101000,\
    0b10010000
.db 0b10010000,\
    0b10010000
.db 0b01101000,\
    0b00000000
// Character 'á' ASCII Code(0XE1)--------------------------------
.db 0b00110000,\
    0b01001000
.db 0b01001000,\
    0b01110000
.db 0b01001000,\
    0b01001000
.db 0b01110000,\
    0b11000000
// Character 'â' ASCII Code(0XE2)--------------------------------
.db 0b11111000,\
    0b10001000
.db 0b10000000,\
    0b10000000
.db 0b10000000,\
    0b10000000
.db 0b10000000,\
    0b00000000
// Character 'ã' ASCII Code(0XE3)--------------------------------
.db 0b11111000,\
    0b01010000
.db 0b01010000,\
    0b01010000
.db 0b01010000,\
    0b01010000
.db 0b10011000,\
    0b00000000
// Character 'ä' ASCII Code(0XE4)--------------------------------
.db 0b11111000,\
    0b10001000
.db 0b01000000,\
    0b00100000
.db 0b01000000,\
    0b10001000
.db 0b11111000,\
    0b00000000
// Character 'å' ASCII Code(0XE5)--------------------------------
.db 0b00000000,\
    0b00000000
.db 0b01111000,\
    0b10010000
.db 0b10010000,\
    0b10010000
.db 0b01100000,\
    0b00000000
// Character 'æ' ASCII Code(0XE6)--------------------------------
.db 0b00000000,\
    0b01010000
.db 0b01010000,\
    0b01010000
.db 0b01010000,\
    0b01101000
.db 0b10000000,\
    0b10000000
// Character 'ç' ASCII Code(0XE7)--------------------------------
.db 0b00000000,\
    0b01010000
.db 0b10100000,\
    0b00100000
.db 0b00100000,\
    0b00100000
.db 0b00100000,\
    0b00000000
// Character 'è' ASCII Code(0XE8)--------------------------------
.db 0b11111000,\
    0b00100000
.db 0b01110000,\
    0b10101000
.db 0b10101000,\
    0b01110000
.db 0b00100000,\
    0b11111000
// Character 'é' ASCII Code(0XE9)--------------------------------
.db 0b00100000,\
    0b01010000
.db 0b10001000,\
    0b11111000
.db 0b10001000,\
    0b01010000
.db 0b00100000,\
    0b00000000
// Character 'ê' ASCII Code(0XEA)--------------------------------
.db 0b01110000,\
    0b10001000
.db 0b10001000,\
    0b10001000
.db 0b01010000,\
    0b01010000
.db 0b11011000,\
    0b00000000
// Character 'ë' ASCII Code(0XEB)--------------------------------
.db 0b00110000,\
    0b01000000
.db 0b01000000,\
    0b00100000
.db 0b01010000,\
    0b01010000
.db 0b01010000,\
    0b00100000
// Character 'ì' ASCII Code(0XEC)--------------------------------
.db 0b00000000,\
    0b00000000
.db 0b00000000,\
    0b01010000
.db 0b10101000,\
    0b10101000
.db 0b01010000,\
    0b00000000
// Character 'í' ASCII Code(0XED)--------------------------------
.db 0b00001000,\
    0b01110000
.db 0b10101000,\
    0b10101000
.db 0b10101000,\
    0b01110000
.db 0b10000000,\
    0b00000000
// Character 'î' ASCII Code(0XEE)--------------------------------
.db 0b00111000,\
    0b01000000
.db 0b10000000,\
    0b11111000
.db 0b10000000,\
    0b01000000
.db 0b00111000,\
    0b00000000
// Character 'ï' ASCII Code(0XEF)--------------------------------
.db 0b01110000,\
    0b10001000
.db 0b10001000,\
    0b10001000
.db 0b10001000,\
    0b10001000
.db 0b10001000,\
    0b00000000
// Character 'ð' ASCII Code(0XF0)--------------------------------
.db 0b00000000,\
    0b00000000
.db 0b11110000,\
    0b00000000
.db 0b11110000,\
    0b00000000
.db 0b11110000,\
    0b00000000
// Character 'ñ' ASCII Code(0XF1)--------------------------------
.db 0b00100000,\
    0b00100000
.db 0b11111000,\
    0b00100000
.db 0b00100000,\
    0b00000000
.db 0b11111000,\
    0b00000000
// Character 'ò' ASCII Code(0XF2)--------------------------------
.db 0b11000000,\
    0b00110000
.db 0b00001000,\
    0b00110000
.db 0b11000000,\
    0b00000000
.db 0b11111000,\
    0b00000000
// Character 'ó' ASCII Code(0XF3)--------------------------------
.db 0b00011000,\
    0b01100000
.db 0b10000000,\
    0b01100000
.db 0b00011000,\
    0b00000000
.db 0b11111000,\
    0b00000000
// Character 'ô' ASCII Code(0XF4)--------------------------------
.db 0b00010000,\
    0b00101000
.db 0b00100000,\
    0b00100000
.db 0b00100000,\
    0b00100000
.db 0b00100000,\
    0b00100000
// Character 'õ' ASCII Code(0XF5)--------------------------------
.db 0b00100000,\
    0b00100000
.db 0b00100000,\
    0b00100000
.db 0b00100000,\
    0b00100000
.db 0b10100000,\
    0b01000000
// Character 'ö' ASCII Code(0XF6)--------------------------------
.db 0b00000000,\
    0b00100000
.db 0b00000000,\
    0b11111000
.db 0b00000000,\
    0b00100000
.db 0b00000000,\
    0b00000000
// Character '÷' ASCII Code(0XF7)--------------------------------
.db 0b00000000,\
    0b01010000
.db 0b10100000,\
    0b00000000
.db 0b01010000,\
    0b10100000
.db 0b00000000,\
    0b00000000
// Character 'ø' ASCII Code(0XF8)--------------------------------
.db 0b00000000,\
    0b00011000
.db 0b00100100,\
    0b00100100
.db 0b00011000,\
    0b00000000
.db 0b00000000,\
    0b00000000
// Character 'ù' ASCII Code(0XF9)--------------------------------
.db 0b00000000,\
    0b00110000
.db 0b01111000,\
    0b01111000
.db 0b00110000,\
    0b00000000
.db 0b00000000,\
    0b00000000
// Character 'ú' ASCII Code(0XFA)--------------------------------
.db 0b00000000,\
    0b00000000
.db 0b00000000,\
    0b00000000
.db 0b00110000,\
    0b00000000
.db 0b00000000,\
    0b00000000
// Character 'û' ASCII Code(0XFB)--------------------------------
.db 0b00111110,\
    0b00100000
.db 0b00100000,\
    0b00100000
.db 0b10100000,\
    0b01100000
.db 0b00100000,\
    0b00000000
// Character 'ü' ASCII Code(0XFC)--------------------------------
.db 0b10100000,\
    0b01010000
.db 0b01010000,\
    0b01010000
.db 0b00000000,\
    0b00000000
.db 0b00000000,\
    0b00000000
// Character 'ý' ASCII Code(0XFD)--------------------------------
.db 0b01000000,\
    0b10100000
.db 0b00100000,\
    0b01000000
.db 0b11100000,\
    0b00000000
.db 0b00000000,\
    0b00000000
// Character 'þ' ASCII Code(0XFE)--------------------------------
.db 0b00000000,\
    0b00111000
.db 0b00111000,\
    0b00111000
.db 0b00111000,\
    0b00111000
.db 0b00111000,\
    0b00000000
// Character 'ÿ' ASCII Code(0XFF)--------------------------------
.db 0b00000000,\
    0b00000000
.db 0b00000000,\
    0b00000000
.db 0b00000000,\
    0b00000000
.db 0b00000000,\
    0b00000000

#endif
*/
.exit
