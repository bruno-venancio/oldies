;+--------------------------------------
;| Generate Assembler File for Atmel AVR Studio 4..7
;|
;| Source
;|     Path : C:\_AVR\_CURINGA2018\RESOURCES\
;|     File : sat.bmp
;|
;| Destiny
;|     Path : C:\_AVR\_CURINGA2018\RESOURCES\
;|     File : BMP_sat.INC
;|
;| Destiny Image Properties
;|     Size   :   512 Bytes
;|     Width  :   128 Pixels
;|     Height :    32 Pixels
;|     WidthB :    16 Bytes
;|     Colors :     2 Levels(1) Bit
;+--------------------------------------

;( IMAGE CONTENTS )

;                                                                                                         1                           
;               1         2         3         4         5         6         7         8         9         0         1         2       
;     01234567890123456789012345678901234567890123456789012345678901234567890123456789012345678901234567890123456789012345678901234567
;     |         |         |         |         |         |         |         |         |         |         |         |         |       
;0000-################################################################################################################################-   0
;0001-################################################################################################################################-   1
;0002-################################################################################################################################-   2
;0003-################################################################################################################################-   3
;0004-################################################################################################################################-   4
;0005-################################################################################################################################-   5
;0006-################################################################################################################################-   6
;0007-################################################################################################################################-   7
;0008-################################################################################################################################-   8
;0009-################################################################################################################################-   9
;0010-################################################################################################################################-  10
;0011-################################################################################################################################-  11
;0012-################################################################################################################################-  12
;0013-################################################################################################################################-  13
;0014-################################################################################################################################-  14
;0015-################################################################################################################################-  15
;0016-################################################################################################################################-  16
;0017-################################################################################################################################-  17
;0018-####################################################################   #########################################################-  18
;0019-#####################################################################   ########################################################-  19
;0020-######################################################################   #######################################################-  20
;0021-#######################################################################     ####################################################-  21
;0022-########################################################################     ###################################################-  22
;0023-########################################################################      ##################################################-  23
;0024-########################################################################     ###################################################-  24
;0025-#########################################################################     ##################################################-  25
;0026-################################################################### #  ### #   #################################################-  26
;0027-###################################################################  # ######   ################################################-  27
;0028-#################################################################### ##  #####   ###############################################-  28
;0029-##################################################################### ## ######  ###############################################-  29
;0030-######################################################################  ########################################################-  30
;0031-######################################################################## #######################################################-  31
;     |         |         |         |         |         |         |         |         |         |         |         |         |       
;                                                                                                         1                           
;               1         2         3         4         5         6         7         8         9         0         1         2       
;     01234567890123456789012345678901234567890123456789012345678901234567890123456789012345678901234567890123456789012345678901234567

;( IMAGE DATA )
 
tela_sat:

	;+------------+
	;| BMP Header |
	;+------------+
	.DW      1 ;Bits Color Bit
	.DW    128 ;Width Pixels
	.DW     32 ;Height Pixels
	.DW     16 ;Width Bytes 
	.DW    512 ;Size Bytes
	;+------------+
	;|  BMP Data  |
	;+------------+
	.DB 0x00,0x00,0x00,0x00,0x00,0x00,0x00,0x00,0x00,0x00,0x00,0x00,0x00,0x00,0x00,0x00;    0
	.DB 0x00,0x00,0x00,0x00,0x00,0x00,0x00,0x00,0x00,0x00,0x00,0x00,0x00,0x00,0x00,0x00;    1
	.DB 0x00,0x00,0x00,0x00,0x00,0x00,0x00,0x00,0x00,0x00,0x00,0x00,0x00,0x00,0x00,0x00;    2
	.DB 0x00,0x00,0x00,0x00,0x00,0x00,0x00,0x00,0x00,0x00,0x00,0x00,0x00,0x00,0x00,0x00;    3
	.DB 0x00,0x00,0x00,0x00,0x00,0x00,0x00,0x00,0x00,0x00,0x00,0x00,0x00,0x00,0x00,0x00;    4
	.DB 0x00,0x00,0x00,0x00,0x00,0x00,0x00,0x00,0x00,0x00,0x00,0x00,0x00,0x00,0x00,0x00;    5
	.DB 0x00,0x00,0x00,0x00,0x00,0x00,0x00,0x00,0x00,0x00,0x00,0x00,0x00,0x00,0x00,0x00;    6
	.DB 0x00,0x00,0x00,0x00,0x00,0x00,0x00,0x00,0x00,0x00,0x00,0x00,0x00,0x00,0x00,0x00;    7
	.DB 0x00,0x00,0x00,0x00,0x00,0x00,0x00,0x00,0x00,0x00,0x00,0x00,0x00,0x00,0x00,0x00;    8
	.DB 0x00,0x00,0x00,0x00,0x00,0x00,0x00,0x00,0x00,0x00,0x00,0x00,0x00,0x00,0x00,0x00;    9
	.DB 0x00,0x00,0x00,0x00,0x00,0x00,0x00,0x00,0x00,0x00,0x00,0x00,0x00,0x00,0x00,0x00;    10
	.DB 0x00,0x00,0x00,0x00,0x00,0x00,0x00,0x00,0x00,0x00,0x00,0x00,0x00,0x00,0x00,0x00;    11
	.DB 0x00,0x00,0x00,0x00,0x00,0x00,0x00,0x00,0x00,0x00,0x00,0x00,0x00,0x00,0x00,0x00;    12
	.DB 0x00,0x00,0x00,0x00,0x00,0x00,0x00,0x00,0x00,0x00,0x00,0x00,0x00,0x00,0x00,0x00;    13
	.DB 0x00,0x00,0x00,0x00,0x00,0x00,0x00,0x00,0x00,0x00,0x00,0x00,0x00,0x00,0x00,0x00;    14
	.DB 0x00,0x00,0x00,0x00,0x00,0x00,0x00,0x00,0x00,0x00,0x00,0x00,0x00,0x00,0x00,0x00;    15
	.DB 0x00,0x00,0x00,0x00,0x00,0x00,0x00,0x00,0x00,0x00,0x00,0x00,0x00,0x00,0x00,0x00;    16
	.DB 0x00,0x00,0x00,0x00,0x00,0x00,0x00,0x00,0x00,0x00,0x00,0x00,0x00,0x00,0x00,0x00;    17
	.DB 0x00,0x00,0x00,0x00,0x00,0x00,0x00,0x00,0x0E,0x00,0x00,0x00,0x00,0x00,0x00,0x00;    18
	.DB 0x00,0x00,0x00,0x00,0x00,0x00,0x00,0x00,0x07,0x00,0x00,0x00,0x00,0x00,0x00,0x00;    19
	.DB 0x00,0x00,0x00,0x00,0x00,0x00,0x00,0x00,0x03,0x80,0x00,0x00,0x00,0x00,0x00,0x00;    20
	.DB 0x00,0x00,0x00,0x00,0x00,0x00,0x00,0x00,0x01,0xF0,0x00,0x00,0x00,0x00,0x00,0x00;    21
	.DB 0x00,0x00,0x00,0x00,0x00,0x00,0x00,0x00,0x00,0xF8,0x00,0x00,0x00,0x00,0x00,0x00;    22
	.DB 0x00,0x00,0x00,0x00,0x00,0x00,0x00,0x00,0x00,0xFC,0x00,0x00,0x00,0x00,0x00,0x00;    23
	.DB 0x00,0x00,0x00,0x00,0x00,0x00,0x00,0x00,0x00,0xF8,0x00,0x00,0x00,0x00,0x00,0x00;    24
	.DB 0x00,0x00,0x00,0x00,0x00,0x00,0x00,0x00,0x00,0x7C,0x00,0x00,0x00,0x00,0x00,0x00;    25
	.DB 0x00,0x00,0x00,0x00,0x00,0x00,0x00,0x00,0x16,0x2E,0x00,0x00,0x00,0x00,0x00,0x00;    26
	.DB 0x00,0x00,0x00,0x00,0x00,0x00,0x00,0x00,0x1A,0x07,0x00,0x00,0x00,0x00,0x00,0x00;    27
	.DB 0x00,0x00,0x00,0x00,0x00,0x00,0x00,0x00,0x09,0x83,0x80,0x00,0x00,0x00,0x00,0x00;    28
	.DB 0x00,0x00,0x00,0x00,0x00,0x00,0x00,0x00,0x04,0x81,0x80,0x00,0x00,0x00,0x00,0x00;    29
	.DB 0x00,0x00,0x00,0x00,0x00,0x00,0x00,0x00,0x03,0x00,0x00,0x00,0x00,0x00,0x00,0x00;    30
	.DB 0x00,0x00,0x00,0x00,0x00,0x00,0x00,0x00,0x00,0x80,0x00,0x00,0x00,0x00,0x00,0x00;    31
	 