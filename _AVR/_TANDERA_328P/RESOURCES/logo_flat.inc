;+---------------------------------------------
;| Generate Assembler File for Atmel AVR Studio 4..7
;|
;| Source
;|     Path : C:\_AVR\_TANDERA\RESOURCES\
;|     File : tand_128_32jj2.jpg
;|
;| Destiny
;|     Path : C:\_AVR\_TANDERA\RESOURCES\
;|     File : BMP_tand_128_32jj2.INC
;|
;| Destiny Image Properties
;|     Size   :   192 Bytes
;|     Width  :   128 Pixels
;|     Height :    12 Pixels
;|     WidthB :    16 Bytes
;|     Colors :     2 Levels(1) Bit
;+---------------------------------------------

;( IMAGE CONTENTS )

;                                                                                                         1                           
;               1         2         3         4         5         6         7         8         9         0         1         2       
;     01234567890123456789012345678901234567890123456789012345678901234567890123456789012345678901234567890123456789012345678901234567
;     |         |         |         |         |         |         |         |         |         |         |         |         |       
;0000-                ###               ###     ######      ##                ##                ##                ###                #-   0
;0001-################################################################################################################################-   1
;0002-                ##                 ##        ###      ##                ##                ##                 ##                 -   2
;0003-#####      #######      #####      ##          #      ##      #####     ##       ###########      #####      ##      ####       -   3
;0004-#####      #######      #####      ##                 ##      #####     ##       ###########      #####      ##      ####       -   4
;0005-#####      #######      #####      ##                 ##      #####     ##                ##      ####      ###      ####       -   5
;0006-#####      #######                 ##      #          ##      #####     ##                ##                ###                 -   6
;0007-#####      #######                 ##      ##         ##      #####     ##       ###########                 ##                 -   7
;0008-#####      #######      #####      ##      ####       ##      #####     ##       ###########      #####      ##      ####       -   8
;0009-#####      #######      #####      ##      #####      ##                ##                ##      #####      ##      ####       -   9
;0010-#####      #######      #####      ##      #####      ##                ##                ##      #####      ##      ####       -  10
;0011-#####      #######      #####      ##      #####      ##                ##                ##      #####      ##      ####       -  11
;     |         |         |         |         |         |         |         |         |         |         |         |         |       
;                                                                                                         1                           
;               1         2         3         4         5         6         7         8         9         0         1         2       
;     01234567890123456789012345678901234567890123456789012345678901234567890123456789012345678901234567890123456789012345678901234567

;( IMAGE DATA )

BMP_LOGO:

	;+------------+
	;| BMP Header |
	;+------------+
	.DW      1 ;Bits Color Bit
	.DW    128 ;Width Pixels
	.DW     12 ;Height Pixels
	.DW     16 ;Width Bytes 
	.DW    192 ;Size Bytes
	;+------------+
	;|  BMP Data  |
	;+------------+
	.DB 0xFF,0xFF,0x1F,0xFF,0xC7,0xC0,0xFC,0xFF,0xFF,0x3F,0xFF,0xCF,0xFF,0xF1,0xFF,0xFE;    0
	.DB 0x00,0x00,0x00,0x00,0x00,0x00,0x00,0x00,0x00,0x00,0x00,0x00,0x00,0x00,0x00,0x00;    1
	.DB 0xFF,0xFF,0x3F,0xFF,0xE7,0xF8,0xFC,0xFF,0xFF,0x3F,0xFF,0xCF,0xFF,0xF9,0xFF,0xFF;    2
	.DB 0x07,0xE0,0x3F,0x07,0xE7,0xFE,0xFC,0xFC,0x1F,0x3F,0x80,0x0F,0xC1,0xF9,0xF8,0x7F;    3
	.DB 0x07,0xE0,0x3F,0x07,0xE7,0xFF,0xFC,0xFC,0x1F,0x3F,0x80,0x0F,0xC1,0xF9,0xF8,0x7F;    4
	.DB 0x07,0xE0,0x3F,0x07,0xE7,0xFF,0xFC,0xFC,0x1F,0x3F,0xFF,0xCF,0xC3,0xF1,0xF8,0x7F;    5
	.DB 0x07,0xE0,0x3F,0xFF,0xE7,0xEF,0xFC,0xFC,0x1F,0x3F,0xFF,0xCF,0xFF,0xF1,0xFF,0xFF;    6
	.DB 0x07,0xE0,0x3F,0xFF,0xE7,0xE7,0xFC,0xFC,0x1F,0x3F,0x80,0x0F,0xFF,0xF9,0xFF,0xFF;    7
	.DB 0x07,0xE0,0x3F,0x07,0xE7,0xE1,0xFC,0xFC,0x1F,0x3F,0x80,0x0F,0xC1,0xF9,0xF8,0x7F;    8
	.DB 0x07,0xE0,0x3F,0x07,0xE7,0xE0,0xFC,0xFF,0xFF,0x3F,0xFF,0xCF,0xC1,0xF9,0xF8,0x7F;    9
	.DB 0x07,0xE0,0x3F,0x07,0xE7,0xE0,0xFC,0xFF,0xFF,0x3F,0xFF,0xCF,0xC1,0xF9,0xF8,0x7F;    10
	.DB 0x07,0xE0,0x3F,0x07,0xE7,0xE0,0xFC,0xFF,0xFF,0x3F,0xFF,0xCF,0xC1,0xF9,0xF8,0x7F;    11
